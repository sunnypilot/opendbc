VERSION ""

NS_ :

BS_:

BU_: XXX

BO_ 528 RADAR_TRACK_210: 32 RADAR
 SG_ CHECKSUM : 0|16@1+ (1,0) [0|65535] "" XXX
 SG_ COUNTER : 16|8@1+ (1,0) [0|255] "" XXX
 SG_ 1_COUNTER_255 : 47|8@0+ (1,0) [0|255] "" XXX
 SG_ 1_STATE_ALT : 51|4@0+ (1,0) [0|15] "" XXX
 SG_ 1_STATE : 55|4@0+ (1,0) [0|15] "" XXX
 SG_ 1_NEW_SIGNAL_3 : 63|8@0- (1,0) [0|255] "" XXX
 SG_ 1_LONG_DIST : 64|12@1+ (0.05,0) [0|4095] "" XXX
 SG_ 1_LAT_DIST : 76|12@1- (0.05,0) [0|4095] "" XXX
 SG_ 1_REL_SPEED : 88|14@1- (0.01,0) [0|16383] "" XXX
 SG_ 1_NEW_SIGNAL_1 : 102|2@1+ (1,0) [0|3] "" XXX
 SG_ 1_NEW_SIGNAL_5 : 104|13@1- (1,0) [0|8191] "" XXX
 SG_ 1_REL_ACCEL : 118|10@1- (1,0) [0|1023] "" XXX
 SG_ 2_COUNTER_255 : 175|8@0+ (1,0) [0|255] "" XXX
 SG_ 2_STATE_ALT : 179|4@0+ (1,0) [0|15] "" XXX
 SG_ 2_STATE : 183|4@0+ (1,0) [0|15] "" XXX
 SG_ 2_NEW_SIGNAL_3 : 191|8@0- (1,0) [0|255] "" XXX
 SG_ 2_LONG_DIST : 192|12@1+ (0.05,0) [0|4095] "" XXX
 SG_ 2_LAT_DIST : 204|12@1- (0.05,0) [0|4095] "" XXX
 SG_ 2_REL_SPEED : 216|14@1- (0.01,0) [0|65535] "" XXX
 SG_ 2_NEW_SIGNAL_1 : 230|2@1+ (1,0) [0|3] "" XXX
 SG_ 2_NEW_SIGNAL_5 : 232|13@1- (1,0) [0|8191] "" XXX
 SG_ 2_REL_ACCEL : 246|10@1- (1,0) [0|1023] "" XXX

BO_ 529 RADAR_TRACK_211: 32 RADAR
 SG_ CHECKSUM : 0|16@1+ (1,0) [0|65535] "" XXX
 SG_ COUNTER : 16|8@1+ (1,0) [0|255] "" XXX
 SG_ 1_COUNTER_255 : 47|8@0+ (1,0) [0|255] "" XXX
 SG_ 1_STATE_ALT : 51|4@0+ (1,0) [0|15] "" XXX
 SG_ 1_STATE : 55|4@0+ (1,0) [0|15] "" XXX
 SG_ 1_NEW_SIGNAL_3 : 63|8@0- (1,0) [0|255] "" XXX
 SG_ 1_LONG_DIST : 64|12@1+ (0.05,0) [0|4095] "" XXX
 SG_ 1_LAT_DIST : 76|12@1- (0.05,0) [0|4095] "" XXX
 SG_ 1_REL_SPEED : 88|14@1- (0.01,0) [0|16383] "" XXX
 SG_ 1_NEW_SIGNAL_1 : 102|2@1+ (1,0) [0|3] "" XXX
 SG_ 1_NEW_SIGNAL_5 : 104|13@1- (1,0) [0|8191] "" XXX
 SG_ 1_REL_ACCEL : 118|10@1- (1,0) [0|1023] "" XXX
 SG_ 2_COUNTER_255 : 175|8@0+ (1,0) [0|255] "" XXX
 SG_ 2_STATE_ALT : 179|4@0+ (1,0) [0|15] "" XXX
 SG_ 2_STATE : 183|4@0+ (1,0) [0|15] "" XXX
 SG_ 2_NEW_SIGNAL_3 : 191|8@0- (1,0) [0|255] "" XXX
 SG_ 2_LONG_DIST : 192|12@1+ (0.05,0) [0|4095] "" XXX
 SG_ 2_LAT_DIST : 204|12@1- (0.05,0) [0|4095] "" XXX
 SG_ 2_REL_SPEED : 216|14@1- (0.01,0) [0|65535] "" XXX
 SG_ 2_NEW_SIGNAL_1 : 230|2@1+ (1,0) [0|3] "" XXX
 SG_ 2_NEW_SIGNAL_5 : 232|13@1- (1,0) [0|8191] "" XXX
 SG_ 2_REL_ACCEL : 246|10@1- (1,0) [0|1023] "" XXX

BO_ 530 RADAR_TRACK_212: 32 RADAR
 SG_ CHECKSUM : 0|16@1+ (1,0) [0|65535] "" XXX
 SG_ COUNTER : 16|8@1+ (1,0) [0|255] "" XXX
 SG_ 1_COUNTER_255 : 47|8@0+ (1,0) [0|255] "" XXX
 SG_ 1_STATE_ALT : 51|4@0+ (1,0) [0|15] "" XXX
 SG_ 1_STATE : 55|4@0+ (1,0) [0|15] "" XXX
 SG_ 1_NEW_SIGNAL_3 : 63|8@0- (1,0) [0|255] "" XXX
 SG_ 1_LONG_DIST : 64|12@1+ (0.05,0) [0|4095] "" XXX
 SG_ 1_LAT_DIST : 76|12@1- (0.05,0) [0|4095] "" XXX
 SG_ 1_REL_SPEED : 88|14@1- (0.01,0) [0|16383] "" XXX
 SG_ 1_NEW_SIGNAL_1 : 102|2@1+ (1,0) [0|3] "" XXX
 SG_ 1_NEW_SIGNAL_5 : 104|13@1- (1,0) [0|8191] "" XXX
 SG_ 1_REL_ACCEL : 118|10@1- (1,0) [0|1023] "" XXX
 SG_ 2_COUNTER_255 : 175|8@0+ (1,0) [0|255] "" XXX
 SG_ 2_STATE_ALT : 179|4@0+ (1,0) [0|15] "" XXX
 SG_ 2_STATE : 183|4@0+ (1,0) [0|15] "" XXX
 SG_ 2_NEW_SIGNAL_3 : 191|8@0- (1,0) [0|255] "" XXX
 SG_ 2_LONG_DIST : 192|12@1+ (0.05,0) [0|4095] "" XXX
 SG_ 2_LAT_DIST : 204|12@1- (0.05,0) [0|4095] "" XXX
 SG_ 2_REL_SPEED : 216|14@1- (0.01,0) [0|65535] "" XXX
 SG_ 2_NEW_SIGNAL_1 : 230|2@1+ (1,0) [0|3] "" XXX
 SG_ 2_NEW_SIGNAL_5 : 232|13@1- (1,0) [0|8191] "" XXX
 SG_ 2_REL_ACCEL : 246|10@1- (1,0) [0|1023] "" XXX

BO_ 531 RADAR_TRACK_213: 32 RADAR
 SG_ CHECKSUM : 0|16@1+ (1,0) [0|65535] "" XXX
 SG_ COUNTER : 16|8@1+ (1,0) [0|255] "" XXX
 SG_ 1_COUNTER_255 : 47|8@0+ (1,0) [0|255] "" XXX
 SG_ 1_STATE_ALT : 51|4@0+ (1,0) [0|15] "" XXX
 SG_ 1_STATE : 55|4@0+ (1,0) [0|15] "" XXX
 SG_ 1_NEW_SIGNAL_3 : 63|8@0- (1,0) [0|255] "" XXX
 SG_ 1_LONG_DIST : 64|12@1+ (0.05,0) [0|4095] "" XXX
 SG_ 1_LAT_DIST : 76|12@1- (0.05,0) [0|4095] "" XXX
 SG_ 1_REL_SPEED : 88|14@1- (0.01,0) [0|16383] "" XXX
 SG_ 1_NEW_SIGNAL_1 : 102|2@1+ (1,0) [0|3] "" XXX
 SG_ 1_NEW_SIGNAL_5 : 104|13@1- (1,0) [0|8191] "" XXX
 SG_ 1_REL_ACCEL : 118|10@1- (1,0) [0|1023] "" XXX
 SG_ 2_COUNTER_255 : 175|8@0+ (1,0) [0|255] "" XXX
 SG_ 2_STATE_ALT : 179|4@0+ (1,0) [0|15] "" XXX
 SG_ 2_STATE : 183|4@0+ (1,0) [0|15] "" XXX
 SG_ 2_NEW_SIGNAL_3 : 191|8@0- (1,0) [0|255] "" XXX
 SG_ 2_LONG_DIST : 192|12@1+ (0.05,0) [0|4095] "" XXX
 SG_ 2_LAT_DIST : 204|12@1- (0.05,0) [0|4095] "" XXX
 SG_ 2_REL_SPEED : 216|14@1- (0.01,0) [0|65535] "" XXX
 SG_ 2_NEW_SIGNAL_1 : 230|2@1+ (1,0) [0|3] "" XXX
 SG_ 2_NEW_SIGNAL_5 : 232|13@1- (1,0) [0|8191] "" XXX
 SG_ 2_REL_ACCEL : 246|10@1- (1,0) [0|1023] "" XXX

BO_ 532 RADAR_TRACK_214: 32 RADAR
 SG_ CHECKSUM : 0|16@1+ (1,0) [0|65535] "" XXX
 SG_ COUNTER : 16|8@1+ (1,0) [0|255] "" XXX
 SG_ 1_COUNTER_255 : 47|8@0+ (1,0) [0|255] "" XXX
 SG_ 1_STATE_ALT : 51|4@0+ (1,0) [0|15] "" XXX
 SG_ 1_STATE : 55|4@0+ (1,0) [0|15] "" XXX
 SG_ 1_NEW_SIGNAL_3 : 63|8@0- (1,0) [0|255] "" XXX
 SG_ 1_LONG_DIST : 64|12@1+ (0.05,0) [0|4095] "" XXX
 SG_ 1_LAT_DIST : 76|12@1- (0.05,0) [0|4095] "" XXX
 SG_ 1_REL_SPEED : 88|14@1- (0.01,0) [0|16383] "" XXX
 SG_ 1_NEW_SIGNAL_1 : 102|2@1+ (1,0) [0|3] "" XXX
 SG_ 1_NEW_SIGNAL_5 : 104|13@1- (1,0) [0|8191] "" XXX
 SG_ 1_REL_ACCEL : 118|10@1- (1,0) [0|1023] "" XXX
 SG_ 2_COUNTER_255 : 175|8@0+ (1,0) [0|255] "" XXX
 SG_ 2_STATE_ALT : 179|4@0+ (1,0) [0|15] "" XXX
 SG_ 2_STATE : 183|4@0+ (1,0) [0|15] "" XXX
 SG_ 2_NEW_SIGNAL_3 : 191|8@0- (1,0) [0|255] "" XXX
 SG_ 2_LONG_DIST : 192|12@1+ (0.05,0) [0|4095] "" XXX
 SG_ 2_LAT_DIST : 204|12@1- (0.05,0) [0|4095] "" XXX
 SG_ 2_REL_SPEED : 216|14@1- (0.01,0) [0|65535] "" XXX
 SG_ 2_NEW_SIGNAL_1 : 230|2@1+ (1,0) [0|3] "" XXX
 SG_ 2_NEW_SIGNAL_5 : 232|13@1- (1,0) [0|8191] "" XXX
 SG_ 2_REL_ACCEL : 246|10@1- (1,0) [0|1023] "" XXX

BO_ 533 RADAR_TRACK_215: 32 RADAR
 SG_ CHECKSUM : 0|16@1+ (1,0) [0|65535] "" XXX
 SG_ COUNTER : 16|8@1+ (1,0) [0|255] "" XXX
 SG_ 1_COUNTER_255 : 47|8@0+ (1,0) [0|255] "" XXX
 SG_ 1_STATE_ALT : 51|4@0+ (1,0) [0|15] "" XXX
 SG_ 1_STATE : 55|4@0+ (1,0) [0|15] "" XXX
 SG_ 1_NEW_SIGNAL_3 : 63|8@0- (1,0) [0|255] "" XXX
 SG_ 1_LONG_DIST : 64|12@1+ (0.05,0) [0|4095] "" XXX
 SG_ 1_LAT_DIST : 76|12@1- (0.05,0) [0|4095] "" XXX
 SG_ 1_REL_SPEED : 88|14@1- (0.01,0) [0|16383] "" XXX
 SG_ 1_NEW_SIGNAL_1 : 102|2@1+ (1,0) [0|3] "" XXX
 SG_ 1_NEW_SIGNAL_5 : 104|13@1- (1,0) [0|8191] "" XXX
 SG_ 1_REL_ACCEL : 118|10@1- (1,0) [0|1023] "" XXX
 SG_ 2_COUNTER_255 : 175|8@0+ (1,0) [0|255] "" XXX
 SG_ 2_STATE_ALT : 179|4@0+ (1,0) [0|15] "" XXX
 SG_ 2_STATE : 183|4@0+ (1,0) [0|15] "" XXX
 SG_ 2_NEW_SIGNAL_3 : 191|8@0- (1,0) [0|255] "" XXX
 SG_ 2_LONG_DIST : 192|12@1+ (0.05,0) [0|4095] "" XXX
 SG_ 2_LAT_DIST : 204|12@1- (0.05,0) [0|4095] "" XXX
 SG_ 2_REL_SPEED : 216|14@1- (0.01,0) [0|65535] "" XXX
 SG_ 2_NEW_SIGNAL_1 : 230|2@1+ (1,0) [0|3] "" XXX
 SG_ 2_NEW_SIGNAL_5 : 232|13@1- (1,0) [0|8191] "" XXX
 SG_ 2_REL_ACCEL : 246|10@1- (1,0) [0|1023] "" XXX

BO_ 534 RADAR_TRACK_216: 32 RADAR
 SG_ CHECKSUM : 0|16@1+ (1,0) [0|65535] "" XXX
 SG_ COUNTER : 16|8@1+ (1,0) [0|255] "" XXX
 SG_ 1_COUNTER_255 : 47|8@0+ (1,0) [0|255] "" XXX
 SG_ 1_STATE_ALT : 51|4@0+ (1,0) [0|15] "" XXX
 SG_ 1_STATE : 55|4@0+ (1,0) [0|15] "" XXX
 SG_ 1_NEW_SIGNAL_3 : 63|8@0- (1,0) [0|255] "" XXX
 SG_ 1_LONG_DIST : 64|12@1+ (0.05,0) [0|4095] "" XXX
 SG_ 1_LAT_DIST : 76|12@1- (0.05,0) [0|4095] "" XXX
 SG_ 1_REL_SPEED : 88|14@1- (0.01,0) [0|16383] "" XXX
 SG_ 1_NEW_SIGNAL_1 : 102|2@1+ (1,0) [0|3] "" XXX
 SG_ 1_NEW_SIGNAL_5 : 104|13@1- (1,0) [0|8191] "" XXX
 SG_ 1_REL_ACCEL : 118|10@1- (1,0) [0|1023] "" XXX
 SG_ 2_COUNTER_255 : 175|8@0+ (1,0) [0|255] "" XXX
 SG_ 2_STATE_ALT : 179|4@0+ (1,0) [0|15] "" XXX
 SG_ 2_STATE : 183|4@0+ (1,0) [0|15] "" XXX
 SG_ 2_NEW_SIGNAL_3 : 191|8@0- (1,0) [0|255] "" XXX
 SG_ 2_LONG_DIST : 192|12@1+ (0.05,0) [0|4095] "" XXX
 SG_ 2_LAT_DIST : 204|12@1- (0.05,0) [0|4095] "" XXX
 SG_ 2_REL_SPEED : 216|14@1- (0.01,0) [0|65535] "" XXX
 SG_ 2_NEW_SIGNAL_1 : 230|2@1+ (1,0) [0|3] "" XXX
 SG_ 2_NEW_SIGNAL_5 : 232|13@1- (1,0) [0|8191] "" XXX
 SG_ 2_REL_ACCEL : 246|10@1- (1,0) [0|1023] "" XXX

BO_ 535 RADAR_TRACK_217: 32 RADAR
 SG_ CHECKSUM : 0|16@1+ (1,0) [0|65535] "" XXX
 SG_ COUNTER : 16|8@1+ (1,0) [0|255] "" XXX
 SG_ 1_COUNTER_255 : 47|8@0+ (1,0) [0|255] "" XXX
 SG_ 1_STATE_ALT : 51|4@0+ (1,0) [0|15] "" XXX
 SG_ 1_STATE : 55|4@0+ (1,0) [0|15] "" XXX
 SG_ 1_NEW_SIGNAL_3 : 63|8@0- (1,0) [0|255] "" XXX
 SG_ 1_LONG_DIST : 64|12@1+ (0.05,0) [0|4095] "" XXX
 SG_ 1_LAT_DIST : 76|12@1- (0.05,0) [0|4095] "" XXX
 SG_ 1_REL_SPEED : 88|14@1- (0.01,0) [0|16383] "" XXX
 SG_ 1_NEW_SIGNAL_1 : 102|2@1+ (1,0) [0|3] "" XXX
 SG_ 1_NEW_SIGNAL_5 : 104|13@1- (1,0) [0|8191] "" XXX
 SG_ 1_REL_ACCEL : 118|10@1- (1,0) [0|1023] "" XXX
 SG_ 2_COUNTER_255 : 175|8@0+ (1,0) [0|255] "" XXX
 SG_ 2_STATE_ALT : 179|4@0+ (1,0) [0|15] "" XXX
 SG_ 2_STATE : 183|4@0+ (1,0) [0|15] "" XXX
 SG_ 2_NEW_SIGNAL_3 : 191|8@0- (1,0) [0|255] "" XXX
 SG_ 2_LONG_DIST : 192|12@1+ (0.05,0) [0|4095] "" XXX
 SG_ 2_LAT_DIST : 204|12@1- (0.05,0) [0|4095] "" XXX
 SG_ 2_REL_SPEED : 216|14@1- (0.01,0) [0|65535] "" XXX
 SG_ 2_NEW_SIGNAL_1 : 230|2@1+ (1,0) [0|3] "" XXX
 SG_ 2_NEW_SIGNAL_5 : 232|13@1- (1,0) [0|8191] "" XXX
 SG_ 2_REL_ACCEL : 246|10@1- (1,0) [0|1023] "" XXX

BO_ 536 RADAR_TRACK_218: 32 RADAR
 SG_ CHECKSUM : 0|16@1+ (1,0) [0|65535] "" XXX
 SG_ COUNTER : 16|8@1+ (1,0) [0|255] "" XXX
 SG_ 1_COUNTER_255 : 47|8@0+ (1,0) [0|255] "" XXX
 SG_ 1_STATE_ALT : 51|4@0+ (1,0) [0|15] "" XXX
 SG_ 1_STATE : 55|4@0+ (1,0) [0|15] "" XXX
 SG_ 1_NEW_SIGNAL_3 : 63|8@0- (1,0) [0|255] "" XXX
 SG_ 1_LONG_DIST : 64|12@1+ (0.05,0) [0|4095] "" XXX
 SG_ 1_LAT_DIST : 76|12@1- (0.05,0) [0|4095] "" XXX
 SG_ 1_REL_SPEED : 88|14@1- (0.01,0) [0|16383] "" XXX
 SG_ 1_NEW_SIGNAL_1 : 102|2@1+ (1,0) [0|3] "" XXX
 SG_ 1_NEW_SIGNAL_5 : 104|13@1- (1,0) [0|8191] "" XXX
 SG_ 1_REL_ACCEL : 118|10@1- (1,0) [0|1023] "" XXX
 SG_ 2_COUNTER_255 : 175|8@0+ (1,0) [0|255] "" XXX
 SG_ 2_STATE_ALT : 179|4@0+ (1,0) [0|15] "" XXX
 SG_ 2_STATE : 183|4@0+ (1,0) [0|15] "" XXX
 SG_ 2_NEW_SIGNAL_3 : 191|8@0- (1,0) [0|255] "" XXX
 SG_ 2_LONG_DIST : 192|12@1+ (0.05,0) [0|4095] "" XXX
 SG_ 2_LAT_DIST : 204|12@1- (0.05,0) [0|4095] "" XXX
 SG_ 2_REL_SPEED : 216|14@1- (0.01,0) [0|65535] "" XXX
 SG_ 2_NEW_SIGNAL_1 : 230|2@1+ (1,0) [0|3] "" XXX
 SG_ 2_NEW_SIGNAL_5 : 232|13@1- (1,0) [0|8191] "" XXX
 SG_ 2_REL_ACCEL : 246|10@1- (1,0) [0|1023] "" XXX

BO_ 537 RADAR_TRACK_219: 32 RADAR
 SG_ CHECKSUM : 0|16@1+ (1,0) [0|65535] "" XXX
 SG_ COUNTER : 16|8@1+ (1,0) [0|255] "" XXX
 SG_ 1_COUNTER_255 : 47|8@0+ (1,0) [0|255] "" XXX
 SG_ 1_STATE_ALT : 51|4@0+ (1,0) [0|15] "" XXX
 SG_ 1_STATE : 55|4@0+ (1,0) [0|15] "" XXX
 SG_ 1_NEW_SIGNAL_3 : 63|8@0- (1,0) [0|255] "" XXX
 SG_ 1_LONG_DIST : 64|12@1+ (0.05,0) [0|4095] "" XXX
 SG_ 1_LAT_DIST : 76|12@1- (0.05,0) [0|4095] "" XXX
 SG_ 1_REL_SPEED : 88|14@1- (0.01,0) [0|16383] "" XXX
 SG_ 1_NEW_SIGNAL_1 : 102|2@1+ (1,0) [0|3] "" XXX
 SG_ 1_NEW_SIGNAL_5 : 104|13@1- (1,0) [0|8191] "" XXX
 SG_ 1_REL_ACCEL : 118|10@1- (1,0) [0|1023] "" XXX
 SG_ 2_COUNTER_255 : 175|8@0+ (1,0) [0|255] "" XXX
 SG_ 2_STATE_ALT : 179|4@0+ (1,0) [0|15] "" XXX
 SG_ 2_STATE : 183|4@0+ (1,0) [0|15] "" XXX
 SG_ 2_NEW_SIGNAL_3 : 191|8@0- (1,0) [0|255] "" XXX
 SG_ 2_LONG_DIST : 192|12@1+ (0.05,0) [0|4095] "" XXX
 SG_ 2_LAT_DIST : 204|12@1- (0.05,0) [0|4095] "" XXX
 SG_ 2_REL_SPEED : 216|14@1- (0.01,0) [0|65535] "" XXX
 SG_ 2_NEW_SIGNAL_1 : 230|2@1+ (1,0) [0|3] "" XXX
 SG_ 2_NEW_SIGNAL_5 : 232|13@1- (1,0) [0|8191] "" XXX
 SG_ 2_REL_ACCEL : 246|10@1- (1,0) [0|1023] "" XXX

BO_ 538 RADAR_TRACK_21a: 32 RADAR
 SG_ CHECKSUM : 0|16@1+ (1,0) [0|65535] "" XXX
 SG_ COUNTER : 16|8@1+ (1,0) [0|255] "" XXX
 SG_ 1_COUNTER_255 : 47|8@0+ (1,0) [0|255] "" XXX
 SG_ 1_STATE_ALT : 51|4@0+ (1,0) [0|15] "" XXX
 SG_ 1_STATE : 55|4@0+ (1,0) [0|15] "" XXX
 SG_ 1_NEW_SIGNAL_3 : 63|8@0- (1,0) [0|255] "" XXX
 SG_ 1_LONG_DIST : 64|12@1+ (0.05,0) [0|4095] "" XXX
 SG_ 1_LAT_DIST : 76|12@1- (0.05,0) [0|4095] "" XXX
 SG_ 1_REL_SPEED : 88|14@1- (0.01,0) [0|16383] "" XXX
 SG_ 1_NEW_SIGNAL_1 : 102|2@1+ (1,0) [0|3] "" XXX
 SG_ 1_NEW_SIGNAL_5 : 104|13@1- (1,0) [0|8191] "" XXX
 SG_ 1_REL_ACCEL : 118|10@1- (1,0) [0|1023] "" XXX
 SG_ 2_COUNTER_255 : 175|8@0+ (1,0) [0|255] "" XXX
 SG_ 2_STATE_ALT : 179|4@0+ (1,0) [0|15] "" XXX
 SG_ 2_STATE : 183|4@0+ (1,0) [0|15] "" XXX
 SG_ 2_NEW_SIGNAL_3 : 191|8@0- (1,0) [0|255] "" XXX
 SG_ 2_LONG_DIST : 192|12@1+ (0.05,0) [0|4095] "" XXX
 SG_ 2_LAT_DIST : 204|12@1- (0.05,0) [0|4095] "" XXX
 SG_ 2_REL_SPEED : 216|14@1- (0.01,0) [0|65535] "" XXX
 SG_ 2_NEW_SIGNAL_1 : 230|2@1+ (1,0) [0|3] "" XXX
 SG_ 2_NEW_SIGNAL_5 : 232|13@1- (1,0) [0|8191] "" XXX
 SG_ 2_REL_ACCEL : 246|10@1- (1,0) [0|1023] "" XXX

BO_ 539 RADAR_TRACK_21b: 32 RADAR
 SG_ CHECKSUM : 0|16@1+ (1,0) [0|65535] "" XXX
 SG_ COUNTER : 16|8@1+ (1,0) [0|255] "" XXX
 SG_ 1_COUNTER_255 : 47|8@0+ (1,0) [0|255] "" XXX
 SG_ 1_STATE_ALT : 51|4@0+ (1,0) [0|15] "" XXX
 SG_ 1_STATE : 55|4@0+ (1,0) [0|15] "" XXX
 SG_ 1_NEW_SIGNAL_3 : 63|8@0- (1,0) [0|255] "" XXX
 SG_ 1_LONG_DIST : 64|12@1+ (0.05,0) [0|4095] "" XXX
 SG_ 1_LAT_DIST : 76|12@1- (0.05,0) [0|4095] "" XXX
 SG_ 1_REL_SPEED : 88|14@1- (0.01,0) [0|16383] "" XXX
 SG_ 1_NEW_SIGNAL_1 : 102|2@1+ (1,0) [0|3] "" XXX
 SG_ 1_NEW_SIGNAL_5 : 104|13@1- (1,0) [0|8191] "" XXX
 SG_ 1_REL_ACCEL : 118|10@1- (1,0) [0|1023] "" XXX
 SG_ 2_COUNTER_255 : 175|8@0+ (1,0) [0|255] "" XXX
 SG_ 2_STATE_ALT : 179|4@0+ (1,0) [0|15] "" XXX
 SG_ 2_STATE : 183|4@0+ (1,0) [0|15] "" XXX
 SG_ 2_NEW_SIGNAL_3 : 191|8@0- (1,0) [0|255] "" XXX
 SG_ 2_LONG_DIST : 192|12@1+ (0.05,0) [0|4095] "" XXX
 SG_ 2_LAT_DIST : 204|12@1- (0.05,0) [0|4095] "" XXX
 SG_ 2_REL_SPEED : 216|14@1- (0.01,0) [0|65535] "" XXX
 SG_ 2_NEW_SIGNAL_1 : 230|2@1+ (1,0) [0|3] "" XXX
 SG_ 2_NEW_SIGNAL_5 : 232|13@1- (1,0) [0|8191] "" XXX
 SG_ 2_REL_ACCEL : 246|10@1- (1,0) [0|1023] "" XXX

BO_ 540 RADAR_TRACK_21c: 32 RADAR
 SG_ CHECKSUM : 0|16@1+ (1,0) [0|65535] "" XXX
 SG_ COUNTER : 16|8@1+ (1,0) [0|255] "" XXX
 SG_ 1_COUNTER_255 : 47|8@0+ (1,0) [0|255] "" XXX
 SG_ 1_STATE_ALT : 51|4@0+ (1,0) [0|15] "" XXX
 SG_ 1_STATE : 55|4@0+ (1,0) [0|15] "" XXX
 SG_ 1_NEW_SIGNAL_3 : 63|8@0- (1,0) [0|255] "" XXX
 SG_ 1_LONG_DIST : 64|12@1+ (0.05,0) [0|4095] "" XXX
 SG_ 1_LAT_DIST : 76|12@1- (0.05,0) [0|4095] "" XXX
 SG_ 1_REL_SPEED : 88|14@1- (0.01,0) [0|16383] "" XXX
 SG_ 1_NEW_SIGNAL_1 : 102|2@1+ (1,0) [0|3] "" XXX
 SG_ 1_NEW_SIGNAL_5 : 104|13@1- (1,0) [0|8191] "" XXX
 SG_ 1_REL_ACCEL : 118|10@1- (1,0) [0|1023] "" XXX
 SG_ 2_COUNTER_255 : 175|8@0+ (1,0) [0|255] "" XXX
 SG_ 2_STATE_ALT : 179|4@0+ (1,0) [0|15] "" XXX
 SG_ 2_STATE : 183|4@0+ (1,0) [0|15] "" XXX
 SG_ 2_NEW_SIGNAL_3 : 191|8@0- (1,0) [0|255] "" XXX
 SG_ 2_LONG_DIST : 192|12@1+ (0.05,0) [0|4095] "" XXX
 SG_ 2_LAT_DIST : 204|12@1- (0.05,0) [0|4095] "" XXX
 SG_ 2_REL_SPEED : 216|14@1- (0.01,0) [0|65535] "" XXX
 SG_ 2_NEW_SIGNAL_1 : 230|2@1+ (1,0) [0|3] "" XXX
 SG_ 2_NEW_SIGNAL_5 : 232|13@1- (1,0) [0|8191] "" XXX
 SG_ 2_REL_ACCEL : 246|10@1- (1,0) [0|1023] "" XXX

BO_ 541 RADAR_TRACK_21d: 32 RADAR
 SG_ CHECKSUM : 0|16@1+ (1,0) [0|65535] "" XXX
 SG_ COUNTER : 16|8@1+ (1,0) [0|255] "" XXX
 SG_ 1_COUNTER_255 : 47|8@0+ (1,0) [0|255] "" XXX
 SG_ 1_STATE_ALT : 51|4@0+ (1,0) [0|15] "" XXX
 SG_ 1_STATE : 55|4@0+ (1,0) [0|15] "" XXX
 SG_ 1_NEW_SIGNAL_3 : 63|8@0- (1,0) [0|255] "" XXX
 SG_ 1_LONG_DIST : 64|12@1+ (0.05,0) [0|4095] "" XXX
 SG_ 1_LAT_DIST : 76|12@1- (0.05,0) [0|4095] "" XXX
 SG_ 1_REL_SPEED : 88|14@1- (0.01,0) [0|16383] "" XXX
 SG_ 1_NEW_SIGNAL_1 : 102|2@1+ (1,0) [0|3] "" XXX
 SG_ 1_NEW_SIGNAL_5 : 104|13@1- (1,0) [0|8191] "" XXX
 SG_ 1_REL_ACCEL : 118|10@1- (1,0) [0|1023] "" XXX
 SG_ 2_COUNTER_255 : 175|8@0+ (1,0) [0|255] "" XXX
 SG_ 2_STATE_ALT : 179|4@0+ (1,0) [0|15] "" XXX
 SG_ 2_STATE : 183|4@0+ (1,0) [0|15] "" XXX
 SG_ 2_NEW_SIGNAL_3 : 191|8@0- (1,0) [0|255] "" XXX
 SG_ 2_LONG_DIST : 192|12@1+ (0.05,0) [0|4095] "" XXX
 SG_ 2_LAT_DIST : 204|12@1- (0.05,0) [0|4095] "" XXX
 SG_ 2_REL_SPEED : 216|14@1- (0.01,0) [0|65535] "" XXX
 SG_ 2_NEW_SIGNAL_1 : 230|2@1+ (1,0) [0|3] "" XXX
 SG_ 2_NEW_SIGNAL_5 : 232|13@1- (1,0) [0|8191] "" XXX
 SG_ 2_REL_ACCEL : 246|10@1- (1,0) [0|1023] "" XXX

BO_ 542 RADAR_TRACK_21e: 32 RADAR
 SG_ CHECKSUM : 0|16@1+ (1,0) [0|65535] "" XXX
 SG_ COUNTER : 16|8@1+ (1,0) [0|255] "" XXX
 SG_ 1_COUNTER_255 : 47|8@0+ (1,0) [0|255] "" XXX
 SG_ 1_STATE_ALT : 51|4@0+ (1,0) [0|15] "" XXX
 SG_ 1_STATE : 55|4@0+ (1,0) [0|15] "" XXX
 SG_ 1_NEW_SIGNAL_3 : 63|8@0- (1,0) [0|255] "" XXX
 SG_ 1_LONG_DIST : 64|12@1+ (0.05,0) [0|4095] "" XXX
 SG_ 1_LAT_DIST : 76|12@1- (0.05,0) [0|4095] "" XXX
 SG_ 1_REL_SPEED : 88|14@1- (0.01,0) [0|16383] "" XXX
 SG_ 1_NEW_SIGNAL_1 : 102|2@1+ (1,0) [0|3] "" XXX
 SG_ 1_NEW_SIGNAL_5 : 104|13@1- (1,0) [0|8191] "" XXX
 SG_ 1_REL_ACCEL : 118|10@1- (1,0) [0|1023] "" XXX
 SG_ 2_COUNTER_255 : 175|8@0+ (1,0) [0|255] "" XXX
 SG_ 2_STATE_ALT : 179|4@0+ (1,0) [0|15] "" XXX
 SG_ 2_STATE : 183|4@0+ (1,0) [0|15] "" XXX
 SG_ 2_NEW_SIGNAL_3 : 191|8@0- (1,0) [0|255] "" XXX
 SG_ 2_LONG_DIST : 192|12@1+ (0.05,0) [0|4095] "" XXX
 SG_ 2_LAT_DIST : 204|12@1- (0.05,0) [0|4095] "" XXX
 SG_ 2_REL_SPEED : 216|14@1- (0.01,0) [0|65535] "" XXX
 SG_ 2_NEW_SIGNAL_1 : 230|2@1+ (1,0) [0|3] "" XXX
 SG_ 2_NEW_SIGNAL_5 : 232|13@1- (1,0) [0|8191] "" XXX
 SG_ 2_REL_ACCEL : 246|10@1- (1,0) [0|1023] "" XXX

BO_ 543 RADAR_TRACK_21f: 32 RADAR
 SG_ CHECKSUM : 0|16@1+ (1,0) [0|65535] "" XXX
 SG_ COUNTER : 16|8@1+ (1,0) [0|255] "" XXX
 SG_ 1_COUNTER_255 : 47|8@0+ (1,0) [0|255] "" XXX
 SG_ 1_STATE_ALT : 51|4@0+ (1,0) [0|15] "" XXX
 SG_ 1_STATE : 55|4@0+ (1,0) [0|15] "" XXX
 SG_ 1_NEW_SIGNAL_3 : 63|8@0- (1,0) [0|255] "" XXX
 SG_ 1_LONG_DIST : 64|12@1+ (0.05,0) [0|4095] "" XXX
 SG_ 1_LAT_DIST : 76|12@1- (0.05,0) [0|4095] "" XXX
 SG_ 1_REL_SPEED : 88|14@1- (0.01,0) [0|16383] "" XXX
 SG_ 1_NEW_SIGNAL_1 : 102|2@1+ (1,0) [0|3] "" XXX
 SG_ 1_NEW_SIGNAL_5 : 104|13@1- (1,0) [0|8191] "" XXX
 SG_ 1_REL_ACCEL : 118|10@1- (1,0) [0|1023] "" XXX
 SG_ 2_COUNTER_255 : 175|8@0+ (1,0) [0|255] "" XXX
 SG_ 2_STATE_ALT : 179|4@0+ (1,0) [0|15] "" XXX
 SG_ 2_STATE : 183|4@0+ (1,0) [0|15] "" XXX
 SG_ 2_NEW_SIGNAL_3 : 191|8@0- (1,0) [0|255] "" XXX
 SG_ 2_LONG_DIST : 192|12@1+ (0.05,0) [0|4095] "" XXX
 SG_ 2_LAT_DIST : 204|12@1- (0.05,0) [0|4095] "" XXX
 SG_ 2_REL_SPEED : 216|14@1- (0.01,0) [0|65535] "" XXX
 SG_ 2_NEW_SIGNAL_1 : 230|2@1+ (1,0) [0|3] "" XXX
 SG_ 2_NEW_SIGNAL_5 : 232|13@1- (1,0) [0|8191] "" XXX
 SG_ 2_REL_ACCEL : 246|10@1- (1,0) [0|1023] "" XXX
