VERSION ""

NS_ :

BS_:

BU_: XXX

BO_ 384 RADAR_TRACK_180: 32 RADAR
 SG_ CHECKSUM : 0|16@1+ (1,0) [0|65535] "" XXX
 SG_ COUNTER : 16|8@1+ (1,0) [0|255] "" XXX
 SG_ 1_LONG : 64|13@1+ (1,0) [0|8191] "" XXX
 SG_ NEW_SIGNAL_2 : 78|12@1+ (1,0) [0|4095] "" XXX
 SG_ NEW_SIGNAL_3 : 91|12@1+ (1,0) [0|4095] "" XXX
 SG_ NEW_SIGNAL_4 : 104|10@1+ (1,0) [0|1023] "" XXX
 SG_ NEW_SIGNAL_5 : 115|9@1- (1,0) [0|511] "" XXX
 SG_ NEW_SIGNAL_6 : 124|16@1+ (1,0) [0|65535] "" XXX
 SG_ 2_LONG : 192|13@1+ (1,0) [0|8191] "" XXX
 SG_ NEW_SIGNAL_12 : 206|12@1+ (1,0) [0|4095] "" XXX
 SG_ NEW_SIGNAL_13 : 219|12@1+ (1,0) [0|4095] "" XXX
 SG_ NEW_SIGNAL_14 : 232|10@1+ (1,0) [0|1023] "" XXX
 SG_ NEW_SIGNAL_8 : 243|9@1- (1,0) [0|511] "" XXX
 SG_ NEW_SIGNAL_9 : 252|4@1+ (1,0) [0|15] "" XXX

BO_ 385 RADAR_TRACK_181: 32 RADAR
 SG_ CHECKSUM : 0|16@1+ (1,0) [0|65535] "" XXX
 SG_ COUNTER : 16|8@1+ (1,0) [0|255] "" XXX
 SG_ 1_LONG : 64|13@1+ (1,0) [0|8191] "" XXX
 SG_ NEW_SIGNAL_2 : 78|12@1+ (1,0) [0|4095] "" XXX
 SG_ NEW_SIGNAL_3 : 91|12@1+ (1,0) [0|4095] "" XXX
 SG_ NEW_SIGNAL_4 : 104|10@1+ (1,0) [0|1023] "" XXX
 SG_ NEW_SIGNAL_5 : 115|9@1- (1,0) [0|511] "" XXX
 SG_ NEW_SIGNAL_6 : 124|16@1+ (1,0) [0|65535] "" XXX
 SG_ 2_LONG : 192|13@1+ (1,0) [0|8191] "" XXX
 SG_ NEW_SIGNAL_12 : 206|12@1+ (1,0) [0|4095] "" XXX
 SG_ NEW_SIGNAL_13 : 219|12@1+ (1,0) [0|4095] "" XXX
 SG_ NEW_SIGNAL_14 : 232|10@1+ (1,0) [0|1023] "" XXX
 SG_ NEW_SIGNAL_8 : 243|9@1- (1,0) [0|511] "" XXX
 SG_ NEW_SIGNAL_9 : 252|4@1+ (1,0) [0|15] "" XXX

BO_ 386 RADAR_TRACK_182: 32 RADAR
 SG_ CHECKSUM : 0|16@1+ (1,0) [0|65535] "" XXX
 SG_ COUNTER : 16|8@1+ (1,0) [0|255] "" XXX
 SG_ 1_LONG : 64|13@1+ (1,0) [0|8191] "" XXX
 SG_ NEW_SIGNAL_2 : 78|12@1+ (1,0) [0|4095] "" XXX
 SG_ NEW_SIGNAL_3 : 91|12@1+ (1,0) [0|4095] "" XXX
 SG_ NEW_SIGNAL_4 : 104|10@1+ (1,0) [0|1023] "" XXX
 SG_ NEW_SIGNAL_5 : 115|9@1- (1,0) [0|511] "" XXX
 SG_ NEW_SIGNAL_6 : 124|16@1+ (1,0) [0|65535] "" XXX
 SG_ 2_LONG : 192|13@1+ (1,0) [0|8191] "" XXX
 SG_ NEW_SIGNAL_12 : 206|12@1+ (1,0) [0|4095] "" XXX
 SG_ NEW_SIGNAL_13 : 219|12@1+ (1,0) [0|4095] "" XXX
 SG_ NEW_SIGNAL_14 : 232|10@1+ (1,0) [0|1023] "" XXX
 SG_ NEW_SIGNAL_8 : 243|9@1- (1,0) [0|511] "" XXX
 SG_ NEW_SIGNAL_9 : 252|4@1+ (1,0) [0|15] "" XXX

BO_ 387 RADAR_TRACK_183: 32 RADAR
 SG_ CHECKSUM : 0|16@1+ (1,0) [0|65535] "" XXX
 SG_ COUNTER : 16|8@1+ (1,0) [0|255] "" XXX
 SG_ 1_LONG : 64|13@1+ (1,0) [0|8191] "" XXX
 SG_ NEW_SIGNAL_2 : 78|12@1+ (1,0) [0|4095] "" XXX
 SG_ NEW_SIGNAL_3 : 91|12@1+ (1,0) [0|4095] "" XXX
 SG_ NEW_SIGNAL_4 : 104|10@1+ (1,0) [0|1023] "" XXX
 SG_ NEW_SIGNAL_5 : 115|9@1- (1,0) [0|511] "" XXX
 SG_ NEW_SIGNAL_6 : 124|16@1+ (1,0) [0|65535] "" XXX
 SG_ 2_LONG : 192|13@1+ (1,0) [0|8191] "" XXX
 SG_ NEW_SIGNAL_12 : 206|12@1+ (1,0) [0|4095] "" XXX
 SG_ NEW_SIGNAL_13 : 219|12@1+ (1,0) [0|4095] "" XXX
 SG_ NEW_SIGNAL_14 : 232|10@1+ (1,0) [0|1023] "" XXX
 SG_ NEW_SIGNAL_8 : 243|9@1- (1,0) [0|511] "" XXX
 SG_ NEW_SIGNAL_9 : 252|4@1+ (1,0) [0|15] "" XXX

BO_ 388 RADAR_TRACK_184: 32 RADAR
 SG_ CHECKSUM : 0|16@1+ (1,0) [0|65535] "" XXX
 SG_ COUNTER : 16|8@1+ (1,0) [0|255] "" XXX
 SG_ 1_LONG : 64|13@1+ (1,0) [0|8191] "" XXX
 SG_ NEW_SIGNAL_2 : 78|12@1+ (1,0) [0|4095] "" XXX
 SG_ NEW_SIGNAL_3 : 91|12@1+ (1,0) [0|4095] "" XXX
 SG_ NEW_SIGNAL_4 : 104|10@1+ (1,0) [0|1023] "" XXX
 SG_ NEW_SIGNAL_5 : 115|9@1- (1,0) [0|511] "" XXX
 SG_ NEW_SIGNAL_6 : 124|16@1+ (1,0) [0|65535] "" XXX
 SG_ 2_LONG : 192|13@1+ (1,0) [0|8191] "" XXX
 SG_ NEW_SIGNAL_12 : 206|12@1+ (1,0) [0|4095] "" XXX
 SG_ NEW_SIGNAL_13 : 219|12@1+ (1,0) [0|4095] "" XXX
 SG_ NEW_SIGNAL_14 : 232|10@1+ (1,0) [0|1023] "" XXX
 SG_ NEW_SIGNAL_8 : 243|9@1- (1,0) [0|511] "" XXX
 SG_ NEW_SIGNAL_9 : 252|4@1+ (1,0) [0|15] "" XXX
