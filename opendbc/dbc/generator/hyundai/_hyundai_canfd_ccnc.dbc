BO_ 74 IMU_01_10ms: 32 CGW_CCU
 SG_ IMU_Crc1Val : 0|16@1+ (1,0) [0|0] ""  ECS,ESC,FCU_C,GW_RGW,ICSC,MDPS,RCU,RWS,SFA,VPC_C
 SG_ IMU_AlvCnt1Val : 16|8@1+ (1,0) [0|0] ""  ECS,ESC,FCU_C,GW_RGW,ICSC,MDPS,RCU,RWS,SFA,VPC_C
 SG_ IMU_YawSigSta : 24|4@1+ (1,0) [0|0] ""  ESC,FCU_C,GW_RGW,MDPS,RCU,RWS,SFA,VPC_C
 SG_ IMU_LatAccelSigSta : 28|4@1+ (1,0) [0|0] ""  ECS,ESC,FCU SG_ IMU_YawRtVal : 64|16@1+ (0.005,-163.84) [0|0] "??/s"  ESC,FCU_C,GW_RGW,ICSC,MDPS,RCU,RWS,SFA,VPC_C
 SG_ IMU_LongAccelSigSta : 32|4@1+ (1,0) [0|15] "" XXX
 SG_ IMU_VerAccelSigSta : 36|4@1+ (1,0) [0|15] "" XXX
 SG_ IMU_McuVoltSta : 40|4@1+ (1,0) [0|15] "" XXX
 SG_ IMU_AcuRstSta : 44|4@1+ (1,0) [0|15] "" XXX
 SG_ IMU_SnsrTyp : 48|8@1+ (1,0) [0|255] "" XXX
 SG_ IMU_RollSigSta : 56|8@1+ (1,0) [0|255] "" XXX
 SG_ IMU_YawRtVal : 64|16@1+ (0.005,-163.84) [0|0] "º/s"  ESC,FCU_C,GW_RGW,ICSC,MDPS,RCU,RWS,SFA,VPC_C
 SG_ IMU_LatAccelVal : 80|16@1+ (0.000127465,-4.17677312) [0|0] "g"  ECS,ESC,FCU_C,GW_RGW,ICSC,MDPS,RCU,RWS,SFA,VPC_C
 SG_ IMU_LongAccelVal : 96|16@1+ (1,0) [0|65535] "" XXX
 SG_ IMU_SnsrTempVal : 112|16@1+ (1,0) [0|65535] "" XXX
 SG_ IMU_SeralNumVal : 128|64@1+ (1,0) [0|1.84467440737096e+19] "" XXX
 SG_ IMU_RollRtVal : 192|16@1+ (0.005,-163.84) [0|0] "º/s" XXX
 SG_ IMU_VerAccelVal : 208|8@1+ (1,0) [0|255] "" XXX

BO_ 229 ESC_02_10ms: 32 CGW
 SG_ ESC_YawSigSta : 24|4@1+ (1,0) [0|15] ""  CLU,ADAS_PRK,FR_CMR,RR_C_RDR
 SG_ ESC_LatAccelSigSta : 28|4@1+ (1,0) [0|15] ""  CLU,ADAS_PRK,FR_CMR,RR_C_RDR
 SG_ ESC_LongAccelSigSta : 32|4@1+ (1,0) [0|15] ""  CLU,ADAS_PRK,FR_CMR,RR_C_RDR
 SG_ ESC_YawRtVal : 64|16@1+ (0.005,-163.84) [-163.84|163.835] "Deg/s"  CLU,ADAS_PRK,FR_CMR,RR_C_RDR
 SG_ ESC_LatAccelVal : 80|16@1+ (0.000127465,-4.17677312) [-4.17677312|4.176645655] "g"  CLU,ADAS_PRK,FR_CMR,RR_C_RDR
 SG_ ESC_LongAccelVal : 96|16@1+ (0.000127465,-4.17677312) [-4.17677312|4.176645655] "g"  CLU,ADAS_PRK,FR_CMR,RR_C_RDR

CM_ BO_ 74 "[P] Periodic";
CM_ SG_ 74 IMU_Crc1Val "The data area for CRC calculation is based on the data length (DLC) of the message DB.The CRC shall be calculated over the entire data block (excluding the CRC bytes) including the user data, alive counter and Data ID- CRC Polynomial (0x1021) , Ini";
CM_ SG_ 74 IMU_AlvCnt1Val "For the first transmission request for a data element the counter shall be initialized with 0 and shall be incremented by 1 for every subsequent send request. When the counter reaches the maximum value(0xFF), then it shall restart with 0 for the next s";
CM_ SG_ 74 IMU_YawSigSta "This signal indicates failure status of yaw rate signal and yaw rate sensing element.0000B : No failure xxx1B : IMU_Yawrate_failurexx1xB : Initialization is runningx1xxB : Reserved1xxxB : ReservedThis signal represents the physica";
CM_ SG_ 74 IMU_LatAccelSigSta "This signal indicates failure status of lateral acceleration signal and sensing element.0000B : No failurexxx1B : IMU_Lateral acceleration failurexx1xB : Initialization is runningx1xxB : Reserved1xxxB : ReservedThis signal represe";
CM_ SG_ 74 IMU_AcuRstSta "This signal indicates the status of IMU.0000B : Normal mode xxx1B : IMU Reset modexx1xB : Reservedx1xxB : Reserved1xxxB : ReservedIf ACU reset is required, ACU will send IMU RESET bit(XXX1B) up to 30 times and perform a reset. If ";
CM_ SG_ 74 IMU_YawRtVal "This signal indicates Information regarding yaw rate.physical range : -163.84..163.83 ˚/s = 0000H..FFFEhConversion : (PH) = ((HEX)-8000H)*0.005[˚/s/digit] = (HEX)*0.005[˚/s/digit] - 163.84[˚/s] ";
CM_ SG_ 74 IMU_LatAccelVal "This signal indicates Information regarding lateral acceleration.physical range : -4.1768g..4.1765g = 0000H..FFFEhConversion : (PH) = ((HEX)-8000H)*0.000127465[g/digit] = (HEX)*0.000127465[g/digit] - 4.17677312[g]";

CM_ BO_ 229 "[P] Periodic";
CM_ SG_ 229 ESC_YawSigSta "ESC_YawSigSta";
CM_ SG_ 229 ESC_LatAccelSigSta "ESC_LatAccelSigSta";
CM_ SG_ 229 ESC_LongAccelSigSta "ESC_LongAccelSigSta";
CM_ SG_ 229 ESC_YawRtVal "ESC_YawRtVal";
CM_ SG_ 229 ESC_LatAccelVal "ESC_LatAccelVal";
CM_ SG_ 229 ESC_LongAccelVal "ESC_LongAccelVal";
