VERSION ""

NS_ :

BS_:

BU_: XXX

BO_ 565 RADAR_TRACK_235: 32 RADAR
 SG_ CHECKSUM : 0|16@1+ (1,0) [0|65535] "" XXX
 SG_ COUNTER : 16|8@1+ (1,0) [0|255] "" XXX
 SG_ NEW_SIGNAL_1 : 64|12@1+ (1,0) [0|4095] "" XXX
 SG_ NEW_SIGNAL_2 : 78|12@1+ (1,0) [0|4095] "" XXX
 SG_ NEW_SIGNAL_3 : 91|12@1+ (1,0) [0|4095] "" XXX
 SG_ NEW_SIGNAL_4 : 104|10@1+ (1,0) [0|1023] "" XXX
 SG_ NEW_SIGNAL_5 : 115|9@1- (1,0) [0|511] "" XXX
 SG_ NEW_SIGNAL_6 : 125|12@1+ (1,0) [0|4095] "" XXX
 SG_ NEW_SIGNAL_7 : 138|12@1+ (1,0) [0|4095] "" XXX
 SG_ NEW_SIGNAL_8 : 151|10@1+ (1,0) [0|1023] "" XXX
 SG_ NEW_SIGNAL_9 : 176|14@1+ (1,0) [0|16383] "" XXX

BO_ 566 RADAR_TRACK_236: 32 RADAR
 SG_ CHECKSUM : 0|16@1+ (1,0) [0|65535] "" XXX
 SG_ COUNTER : 16|8@1+ (1,0) [0|255] "" XXX
 SG_ NEW_SIGNAL_1 : 64|12@1+ (1,0) [0|4095] "" XXX
 SG_ NEW_SIGNAL_2 : 78|12@1+ (1,0) [0|4095] "" XXX
 SG_ NEW_SIGNAL_3 : 91|12@1+ (1,0) [0|4095] "" XXX
 SG_ NEW_SIGNAL_4 : 104|10@1+ (1,0) [0|1023] "" XXX
 SG_ NEW_SIGNAL_5 : 115|9@1- (1,0) [0|511] "" XXX
 SG_ NEW_SIGNAL_6 : 125|12@1+ (1,0) [0|4095] "" XXX
 SG_ NEW_SIGNAL_7 : 138|12@1+ (1,0) [0|4095] "" XXX
 SG_ NEW_SIGNAL_8 : 151|10@1+ (1,0) [0|1023] "" XXX
 SG_ NEW_SIGNAL_9 : 176|14@1+ (1,0) [0|16383] "" XXX

BO_ 567 RADAR_TRACK_237: 32 RADAR
 SG_ CHECKSUM : 0|16@1+ (1,0) [0|65535] "" XXX
 SG_ COUNTER : 16|8@1+ (1,0) [0|255] "" XXX
 SG_ NEW_SIGNAL_1 : 64|12@1+ (1,0) [0|4095] "" XXX
 SG_ NEW_SIGNAL_2 : 78|12@1+ (1,0) [0|4095] "" XXX
 SG_ NEW_SIGNAL_3 : 91|12@1+ (1,0) [0|4095] "" XXX
 SG_ NEW_SIGNAL_4 : 104|10@1+ (1,0) [0|1023] "" XXX
 SG_ NEW_SIGNAL_5 : 115|9@1- (1,0) [0|511] "" XXX
 SG_ NEW_SIGNAL_6 : 125|12@1+ (1,0) [0|4095] "" XXX
 SG_ NEW_SIGNAL_7 : 138|12@1+ (1,0) [0|4095] "" XXX
 SG_ NEW_SIGNAL_8 : 151|10@1+ (1,0) [0|1023] "" XXX
 SG_ NEW_SIGNAL_9 : 176|14@1+ (1,0) [0|16383] "" XXX

BO_ 568 RADAR_TRACK_238: 32 RADAR
 SG_ CHECKSUM : 0|16@1+ (1,0) [0|65535] "" XXX
 SG_ COUNTER : 16|8@1+ (1,0) [0|255] "" XXX
 SG_ NEW_SIGNAL_1 : 64|12@1+ (1,0) [0|4095] "" XXX
 SG_ NEW_SIGNAL_2 : 78|12@1+ (1,0) [0|4095] "" XXX
 SG_ NEW_SIGNAL_3 : 91|12@1+ (1,0) [0|4095] "" XXX
 SG_ NEW_SIGNAL_4 : 104|10@1+ (1,0) [0|1023] "" XXX
 SG_ NEW_SIGNAL_5 : 115|9@1- (1,0) [0|511] "" XXX
 SG_ NEW_SIGNAL_6 : 125|12@1+ (1,0) [0|4095] "" XXX
 SG_ NEW_SIGNAL_7 : 138|12@1+ (1,0) [0|4095] "" XXX
 SG_ NEW_SIGNAL_8 : 151|10@1+ (1,0) [0|1023] "" XXX
 SG_ NEW_SIGNAL_9 : 176|14@1+ (1,0) [0|16383] "" XXX

BO_ 569 RADAR_TRACK_239: 32 RADAR
 SG_ CHECKSUM : 0|16@1+ (1,0) [0|65535] "" XXX
 SG_ COUNTER : 16|8@1+ (1,0) [0|255] "" XXX
 SG_ NEW_SIGNAL_1 : 64|12@1+ (1,0) [0|4095] "" XXX
 SG_ NEW_SIGNAL_2 : 78|12@1+ (1,0) [0|4095] "" XXX
 SG_ NEW_SIGNAL_3 : 91|12@1+ (1,0) [0|4095] "" XXX
 SG_ NEW_SIGNAL_4 : 104|10@1+ (1,0) [0|1023] "" XXX
 SG_ NEW_SIGNAL_5 : 115|9@1- (1,0) [0|511] "" XXX
 SG_ NEW_SIGNAL_6 : 125|12@1+ (1,0) [0|4095] "" XXX
 SG_ NEW_SIGNAL_7 : 138|12@1+ (1,0) [0|4095] "" XXX
 SG_ NEW_SIGNAL_8 : 151|10@1+ (1,0) [0|1023] "" XXX
 SG_ NEW_SIGNAL_9 : 176|14@1+ (1,0) [0|16383] "" XXX

BO_ 570 RADAR_TRACK_23a: 32 RADAR
 SG_ CHECKSUM : 0|16@1+ (1,0) [0|65535] "" XXX
 SG_ COUNTER : 16|8@1+ (1,0) [0|255] "" XXX
 SG_ NEW_SIGNAL_1 : 64|12@1+ (1,0) [0|4095] "" XXX
 SG_ NEW_SIGNAL_2 : 78|12@1+ (1,0) [0|4095] "" XXX
 SG_ NEW_SIGNAL_3 : 91|12@1+ (1,0) [0|4095] "" XXX
 SG_ NEW_SIGNAL_4 : 104|10@1+ (1,0) [0|1023] "" XXX
 SG_ NEW_SIGNAL_5 : 115|9@1- (1,0) [0|511] "" XXX
 SG_ NEW_SIGNAL_6 : 125|12@1+ (1,0) [0|4095] "" XXX
 SG_ NEW_SIGNAL_7 : 138|12@1+ (1,0) [0|4095] "" XXX
 SG_ NEW_SIGNAL_8 : 151|10@1+ (1,0) [0|1023] "" XXX
 SG_ NEW_SIGNAL_9 : 176|14@1+ (1,0) [0|16383] "" XXX

BO_ 571 RADAR_TRACK_23b: 32 RADAR
 SG_ CHECKSUM : 0|16@1+ (1,0) [0|65535] "" XXX
 SG_ COUNTER : 16|8@1+ (1,0) [0|255] "" XXX
 SG_ NEW_SIGNAL_1 : 64|12@1+ (1,0) [0|4095] "" XXX
 SG_ NEW_SIGNAL_2 : 78|12@1+ (1,0) [0|4095] "" XXX
 SG_ NEW_SIGNAL_3 : 91|12@1+ (1,0) [0|4095] "" XXX
 SG_ NEW_SIGNAL_4 : 104|10@1+ (1,0) [0|1023] "" XXX
 SG_ NEW_SIGNAL_5 : 115|9@1- (1,0) [0|511] "" XXX
 SG_ NEW_SIGNAL_6 : 125|12@1+ (1,0) [0|4095] "" XXX
 SG_ NEW_SIGNAL_7 : 138|12@1+ (1,0) [0|4095] "" XXX
 SG_ NEW_SIGNAL_8 : 151|10@1+ (1,0) [0|1023] "" XXX
 SG_ NEW_SIGNAL_9 : 176|14@1+ (1,0) [0|16383] "" XXX

BO_ 572 RADAR_TRACK_23c: 32 RADAR
 SG_ CHECKSUM : 0|16@1+ (1,0) [0|65535] "" XXX
 SG_ COUNTER : 16|8@1+ (1,0) [0|255] "" XXX
 SG_ NEW_SIGNAL_1 : 64|12@1+ (1,0) [0|4095] "" XXX
 SG_ NEW_SIGNAL_2 : 78|12@1+ (1,0) [0|4095] "" XXX
 SG_ NEW_SIGNAL_3 : 91|12@1+ (1,0) [0|4095] "" XXX
 SG_ NEW_SIGNAL_4 : 104|10@1+ (1,0) [0|1023] "" XXX
 SG_ NEW_SIGNAL_5 : 115|9@1- (1,0) [0|511] "" XXX
 SG_ NEW_SIGNAL_6 : 125|12@1+ (1,0) [0|4095] "" XXX
 SG_ NEW_SIGNAL_7 : 138|12@1+ (1,0) [0|4095] "" XXX
 SG_ NEW_SIGNAL_8 : 151|10@1+ (1,0) [0|1023] "" XXX
 SG_ NEW_SIGNAL_9 : 176|14@1+ (1,0) [0|16383] "" XXX

BO_ 573 RADAR_TRACK_23d: 32 RADAR
 SG_ CHECKSUM : 0|16@1+ (1,0) [0|65535] "" XXX
 SG_ COUNTER : 16|8@1+ (1,0) [0|255] "" XXX
 SG_ NEW_SIGNAL_1 : 64|12@1+ (1,0) [0|4095] "" XXX
 SG_ NEW_SIGNAL_2 : 78|12@1+ (1,0) [0|4095] "" XXX
 SG_ NEW_SIGNAL_3 : 91|12@1+ (1,0) [0|4095] "" XXX
 SG_ NEW_SIGNAL_4 : 104|10@1+ (1,0) [0|1023] "" XXX
 SG_ NEW_SIGNAL_5 : 115|9@1- (1,0) [0|511] "" XXX
 SG_ NEW_SIGNAL_6 : 125|12@1+ (1,0) [0|4095] "" XXX
 SG_ NEW_SIGNAL_7 : 138|12@1+ (1,0) [0|4095] "" XXX
 SG_ NEW_SIGNAL_8 : 151|10@1+ (1,0) [0|1023] "" XXX
 SG_ NEW_SIGNAL_9 : 176|14@1+ (1,0) [0|16383] "" XXX

BO_ 574 RADAR_TRACK_23e: 32 RADAR
 SG_ CHECKSUM : 0|16@1+ (1,0) [0|65535] "" XXX
 SG_ COUNTER : 16|8@1+ (1,0) [0|255] "" XXX
 SG_ NEW_SIGNAL_1 : 64|12@1+ (1,0) [0|4095] "" XXX
 SG_ NEW_SIGNAL_2 : 78|12@1+ (1,0) [0|4095] "" XXX
 SG_ NEW_SIGNAL_3 : 91|12@1+ (1,0) [0|4095] "" XXX
 SG_ NEW_SIGNAL_4 : 104|10@1+ (1,0) [0|1023] "" XXX
 SG_ NEW_SIGNAL_5 : 115|9@1- (1,0) [0|511] "" XXX
 SG_ NEW_SIGNAL_6 : 125|12@1+ (1,0) [0|4095] "" XXX
 SG_ NEW_SIGNAL_7 : 138|12@1+ (1,0) [0|4095] "" XXX
 SG_ NEW_SIGNAL_8 : 151|10@1+ (1,0) [0|1023] "" XXX
 SG_ NEW_SIGNAL_9 : 176|14@1+ (1,0) [0|16383] "" XXX

BO_ 575 RADAR_TRACK_23f: 32 RADAR
 SG_ CHECKSUM : 0|16@1+ (1,0) [0|65535] "" XXX
 SG_ COUNTER : 16|8@1+ (1,0) [0|255] "" XXX
 SG_ NEW_SIGNAL_1 : 64|12@1+ (1,0) [0|4095] "" XXX
 SG_ NEW_SIGNAL_2 : 78|12@1+ (1,0) [0|4095] "" XXX
 SG_ NEW_SIGNAL_3 : 91|12@1+ (1,0) [0|4095] "" XXX
 SG_ NEW_SIGNAL_4 : 104|10@1+ (1,0) [0|1023] "" XXX
 SG_ NEW_SIGNAL_5 : 115|9@1- (1,0) [0|511] "" XXX
 SG_ NEW_SIGNAL_6 : 125|12@1+ (1,0) [0|4095] "" XXX
 SG_ NEW_SIGNAL_7 : 138|12@1+ (1,0) [0|4095] "" XXX
 SG_ NEW_SIGNAL_8 : 151|10@1+ (1,0) [0|1023] "" XXX
 SG_ NEW_SIGNAL_9 : 176|14@1+ (1,0) [0|16383] "" XXX

BO_ 576 RADAR_TRACK_240: 32 RADAR
 SG_ CHECKSUM : 0|16@1+ (1,0) [0|65535] "" XXX
 SG_ COUNTER : 16|8@1+ (1,0) [0|255] "" XXX
 SG_ NEW_SIGNAL_1 : 64|12@1+ (1,0) [0|4095] "" XXX
 SG_ NEW_SIGNAL_2 : 78|12@1+ (1,0) [0|4095] "" XXX
 SG_ NEW_SIGNAL_3 : 91|12@1+ (1,0) [0|4095] "" XXX
 SG_ NEW_SIGNAL_4 : 104|10@1+ (1,0) [0|1023] "" XXX
 SG_ NEW_SIGNAL_5 : 115|9@1- (1,0) [0|511] "" XXX
 SG_ NEW_SIGNAL_6 : 125|12@1+ (1,0) [0|4095] "" XXX
 SG_ NEW_SIGNAL_7 : 138|12@1+ (1,0) [0|4095] "" XXX
 SG_ NEW_SIGNAL_8 : 151|10@1+ (1,0) [0|1023] "" XXX
 SG_ NEW_SIGNAL_9 : 176|14@1+ (1,0) [0|16383] "" XXX

BO_ 577 RADAR_TRACK_241: 32 RADAR
 SG_ CHECKSUM : 0|16@1+ (1,0) [0|65535] "" XXX
 SG_ COUNTER : 16|8@1+ (1,0) [0|255] "" XXX
 SG_ NEW_SIGNAL_1 : 64|12@1+ (1,0) [0|4095] "" XXX
 SG_ NEW_SIGNAL_2 : 78|12@1+ (1,0) [0|4095] "" XXX
 SG_ NEW_SIGNAL_3 : 91|12@1+ (1,0) [0|4095] "" XXX
 SG_ NEW_SIGNAL_4 : 104|10@1+ (1,0) [0|1023] "" XXX
 SG_ NEW_SIGNAL_5 : 115|9@1- (1,0) [0|511] "" XXX
 SG_ NEW_SIGNAL_6 : 125|12@1+ (1,0) [0|4095] "" XXX
 SG_ NEW_SIGNAL_7 : 138|12@1+ (1,0) [0|4095] "" XXX
 SG_ NEW_SIGNAL_8 : 151|10@1+ (1,0) [0|1023] "" XXX
 SG_ NEW_SIGNAL_9 : 176|14@1+ (1,0) [0|16383] "" XXX

BO_ 578 RADAR_TRACK_242: 32 RADAR
 SG_ CHECKSUM : 0|16@1+ (1,0) [0|65535] "" XXX
 SG_ COUNTER : 16|8@1+ (1,0) [0|255] "" XXX
 SG_ NEW_SIGNAL_1 : 64|12@1+ (1,0) [0|4095] "" XXX
 SG_ NEW_SIGNAL_2 : 78|12@1+ (1,0) [0|4095] "" XXX
 SG_ NEW_SIGNAL_3 : 91|12@1+ (1,0) [0|4095] "" XXX
 SG_ NEW_SIGNAL_4 : 104|10@1+ (1,0) [0|1023] "" XXX
 SG_ NEW_SIGNAL_5 : 115|9@1- (1,0) [0|511] "" XXX
 SG_ NEW_SIGNAL_6 : 125|12@1+ (1,0) [0|4095] "" XXX
 SG_ NEW_SIGNAL_7 : 138|12@1+ (1,0) [0|4095] "" XXX
 SG_ NEW_SIGNAL_8 : 151|10@1+ (1,0) [0|1023] "" XXX
 SG_ NEW_SIGNAL_9 : 176|14@1+ (1,0) [0|16383] "" XXX

BO_ 579 RADAR_TRACK_243: 32 RADAR
 SG_ CHECKSUM : 0|16@1+ (1,0) [0|65535] "" XXX
 SG_ COUNTER : 16|8@1+ (1,0) [0|255] "" XXX
 SG_ NEW_SIGNAL_1 : 64|12@1+ (1,0) [0|4095] "" XXX
 SG_ NEW_SIGNAL_2 : 78|12@1+ (1,0) [0|4095] "" XXX
 SG_ NEW_SIGNAL_3 : 91|12@1+ (1,0) [0|4095] "" XXX
 SG_ NEW_SIGNAL_4 : 104|10@1+ (1,0) [0|1023] "" XXX
 SG_ NEW_SIGNAL_5 : 115|9@1- (1,0) [0|511] "" XXX
 SG_ NEW_SIGNAL_6 : 125|12@1+ (1,0) [0|4095] "" XXX
 SG_ NEW_SIGNAL_7 : 138|12@1+ (1,0) [0|4095] "" XXX
 SG_ NEW_SIGNAL_8 : 151|10@1+ (1,0) [0|1023] "" XXX
 SG_ NEW_SIGNAL_9 : 176|14@1+ (1,0) [0|16383] "" XXX

BO_ 580 RADAR_TRACK_244: 32 RADAR
 SG_ CHECKSUM : 0|16@1+ (1,0) [0|65535] "" XXX
 SG_ COUNTER : 16|8@1+ (1,0) [0|255] "" XXX
 SG_ NEW_SIGNAL_1 : 64|12@1+ (1,0) [0|4095] "" XXX
 SG_ NEW_SIGNAL_2 : 78|12@1+ (1,0) [0|4095] "" XXX
 SG_ NEW_SIGNAL_3 : 91|12@1+ (1,0) [0|4095] "" XXX
 SG_ NEW_SIGNAL_4 : 104|10@1+ (1,0) [0|1023] "" XXX
 SG_ NEW_SIGNAL_5 : 115|9@1- (1,0) [0|511] "" XXX
 SG_ NEW_SIGNAL_6 : 125|12@1+ (1,0) [0|4095] "" XXX
 SG_ NEW_SIGNAL_7 : 138|12@1+ (1,0) [0|4095] "" XXX
 SG_ NEW_SIGNAL_8 : 151|10@1+ (1,0) [0|1023] "" XXX
 SG_ NEW_SIGNAL_9 : 176|14@1+ (1,0) [0|16383] "" XXX

BO_ 581 RADAR_TRACK_245: 32 RADAR
 SG_ CHECKSUM : 0|16@1+ (1,0) [0|65535] "" XXX
 SG_ COUNTER : 16|8@1+ (1,0) [0|255] "" XXX
 SG_ NEW_SIGNAL_1 : 64|12@1+ (1,0) [0|4095] "" XXX
 SG_ NEW_SIGNAL_2 : 78|12@1+ (1,0) [0|4095] "" XXX
 SG_ NEW_SIGNAL_3 : 91|12@1+ (1,0) [0|4095] "" XXX
 SG_ NEW_SIGNAL_4 : 104|10@1+ (1,0) [0|1023] "" XXX
 SG_ NEW_SIGNAL_5 : 115|9@1- (1,0) [0|511] "" XXX
 SG_ NEW_SIGNAL_6 : 125|12@1+ (1,0) [0|4095] "" XXX
 SG_ NEW_SIGNAL_7 : 138|12@1+ (1,0) [0|4095] "" XXX
 SG_ NEW_SIGNAL_8 : 151|10@1+ (1,0) [0|1023] "" XXX
 SG_ NEW_SIGNAL_9 : 176|14@1+ (1,0) [0|16383] "" XXX

BO_ 582 RADAR_TRACK_246: 32 RADAR
 SG_ CHECKSUM : 0|16@1+ (1,0) [0|65535] "" XXX
 SG_ COUNTER : 16|8@1+ (1,0) [0|255] "" XXX
 SG_ NEW_SIGNAL_1 : 64|12@1+ (1,0) [0|4095] "" XXX
 SG_ NEW_SIGNAL_2 : 78|12@1+ (1,0) [0|4095] "" XXX
 SG_ NEW_SIGNAL_3 : 91|12@1+ (1,0) [0|4095] "" XXX
 SG_ NEW_SIGNAL_4 : 104|10@1+ (1,0) [0|1023] "" XXX
 SG_ NEW_SIGNAL_5 : 115|9@1- (1,0) [0|511] "" XXX
 SG_ NEW_SIGNAL_6 : 125|12@1+ (1,0) [0|4095] "" XXX
 SG_ NEW_SIGNAL_7 : 138|12@1+ (1,0) [0|4095] "" XXX
 SG_ NEW_SIGNAL_8 : 151|10@1+ (1,0) [0|1023] "" XXX
 SG_ NEW_SIGNAL_9 : 176|14@1+ (1,0) [0|16383] "" XXX

BO_ 583 RADAR_TRACK_247: 32 RADAR
 SG_ CHECKSUM : 0|16@1+ (1,0) [0|65535] "" XXX
 SG_ COUNTER : 16|8@1+ (1,0) [0|255] "" XXX
 SG_ NEW_SIGNAL_1 : 64|12@1+ (1,0) [0|4095] "" XXX
 SG_ NEW_SIGNAL_2 : 78|12@1+ (1,0) [0|4095] "" XXX
 SG_ NEW_SIGNAL_3 : 91|12@1+ (1,0) [0|4095] "" XXX
 SG_ NEW_SIGNAL_4 : 104|10@1+ (1,0) [0|1023] "" XXX
 SG_ NEW_SIGNAL_5 : 115|9@1- (1,0) [0|511] "" XXX
 SG_ NEW_SIGNAL_6 : 125|12@1+ (1,0) [0|4095] "" XXX
 SG_ NEW_SIGNAL_7 : 138|12@1+ (1,0) [0|4095] "" XXX
 SG_ NEW_SIGNAL_8 : 151|10@1+ (1,0) [0|1023] "" XXX
 SG_ NEW_SIGNAL_9 : 176|14@1+ (1,0) [0|16383] "" XXX

BO_ 584 RADAR_TRACK_248: 32 RADAR
 SG_ CHECKSUM : 0|16@1+ (1,0) [0|65535] "" XXX
 SG_ COUNTER : 16|8@1+ (1,0) [0|255] "" XXX
 SG_ NEW_SIGNAL_1 : 64|12@1+ (1,0) [0|4095] "" XXX
 SG_ NEW_SIGNAL_2 : 78|12@1+ (1,0) [0|4095] "" XXX
 SG_ NEW_SIGNAL_3 : 91|12@1+ (1,0) [0|4095] "" XXX
 SG_ NEW_SIGNAL_4 : 104|10@1+ (1,0) [0|1023] "" XXX
 SG_ NEW_SIGNAL_5 : 115|9@1- (1,0) [0|511] "" XXX
 SG_ NEW_SIGNAL_6 : 125|12@1+ (1,0) [0|4095] "" XXX
 SG_ NEW_SIGNAL_7 : 138|12@1+ (1,0) [0|4095] "" XXX
 SG_ NEW_SIGNAL_8 : 151|10@1+ (1,0) [0|1023] "" XXX
 SG_ NEW_SIGNAL_9 : 176|14@1+ (1,0) [0|16383] "" XXX
