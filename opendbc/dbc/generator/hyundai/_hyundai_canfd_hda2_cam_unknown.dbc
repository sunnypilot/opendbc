BO_ 560 NEW_MSG_230: 16 FR_CMR_OR_CAR
 SG_ CHECKSUM : 7|16@0+ (1,0) [0|65535] "" XXX
 SG_ COUNTER : 16|8@1+ (1,0) [0|255] "" XXX

BO_ 565 NEW_MSG_235: 32 FR_CMR_OR_CAR
 SG_ CHECKSUM : 7|16@0+ (1,0) [0|65535] "" XXX
 SG_ COUNTER : 16|8@1+ (1,0) [0|255] "" XXX

BO_ 566 NEW_MSG_236: 32 FR_CMR
 SG_ CHECKSUM : 7|16@0+ (1,0) [0|65535] "" XXX
 SG_ COUNTER : 16|8@1+ (1,0) [0|255] "" XXX

BO_ 567 NEW_MSG_237: 32 FR_CMR
 SG_ CHECKSUM : 7|16@0+ (1,0) [0|65535] "" XXX
 SG_ COUNTER : 16|8@1+ (1,0) [0|255] "" XXX

BO_ 568 NEW_MSG_238: 32 FR_CMR
 SG_ CHECKSUM : 7|16@0+ (1,0) [0|65535] "" XXX
 SG_ COUNTER : 16|8@1+ (1,0) [0|255] "" XXX

BO_ 569 NEW_MSG_239: 32 FR_CMR
 SG_ CHECKSUM : 7|16@0+ (1,0) [0|65535] "" XXX
 SG_ COUNTER : 16|8@1+ (1,0) [0|255] "" XXX

BO_ 570 NEW_MSG_23A: 32 FR_CMR
 SG_ CHECKSUM : 7|16@0+ (1,0) [0|65535] "" XXX
 SG_ COUNTER : 16|8@1+ (1,0) [0|255] "" XXX

BO_ 571 NEW_MSG_23B: 32 FR_CMR_OR_CAR
 SG_ CHECKSUM : 7|16@0+ (1,0) [0|65535] "" XXX
 SG_ COUNTER : 16|8@1+ (1,0) [0|255] "" XXX

BO_ 572 NEW_MSG_23C: 32 FR_CMR
 SG_ CHECKSUM : 7|16@0+ (1,0) [0|65535] "" XXX
 SG_ COUNTER : 16|8@1+ (1,0) [0|255] "" XXX

BO_ 573 NEW_MSG_23D: 32 FR_CMR
 SG_ CHECKSUM : 7|16@0+ (1,0) [0|65535] "" XXX
 SG_ COUNTER : 16|8@1+ (1,0) [0|255] "" XXX

BO_ 574 NEW_MSG_23E: 32 FR_CMR
 SG_ CHECKSUM : 7|16@0+ (1,0) [0|65535] "" XXX
 SG_ COUNTER : 16|8@1+ (1,0) [0|255] "" XXX

BO_ 575 NEW_MSG_23F: 32 FR_CMR
 SG_ CHECKSUM : 7|16@0+ (1,0) [0|65535] "" XXX
 SG_ COUNTER : 16|8@1+ (1,0) [0|255] "" XXX

BO_ 577 NEW_MSG_241: 32 FR_CMR
 SG_ CHECKSUM : 7|16@0+ (1,0) [0|65535] "" XXX
 SG_ COUNTER : 16|8@1+ (1,0) [0|255] "" XXX

BO_ 578 NEW_MSG_242: 32 FR_CMR
 SG_ CHECKSUM : 7|16@0+ (1,0) [0|65535] "" XXX
 SG_ COUNTER : 16|8@1+ (1,0) [0|255] "" XXX

BO_ 579 NEW_MSG_243: 32 FR_CMR
 SG_ CHECKSUM : 7|16@0+ (1,0) [0|65535] "" XXX
 SG_ COUNTER : 16|8@1+ (1,0) [0|255] "" XXX

BO_ 580 NEW_MSG_244: 32 FR_CMR
 SG_ CHECKSUM : 7|16@0+ (1,0) [0|65535] "" XXX
 SG_ COUNTER : 16|8@1+ (1,0) [0|255] "" XXX

BO_ 581 NEW_MSG_245: 32 FR_CMR
 SG_ CHECKSUM : 7|16@0+ (1,0) [0|65535] "" XXX
 SG_ COUNTER : 16|8@1+ (1,0) [0|255] "" XXX

BO_ 582 NEW_MSG_246: 32 FR_CMR
 SG_ CHECKSUM : 7|16@0+ (1,0) [0|65535] "" XXX
 SG_ COUNTER : 16|8@1+ (1,0) [0|255] "" XXX

BO_ 583 NEW_MSG_247: 32 FR_CMR
 SG_ CHECKSUM : 7|16@0+ (1,0) [0|65535] "" XXX
 SG_ COUNTER : 16|8@1+ (1,0) [0|255] "" XXX

BO_ 584 NEW_MSG_248: 32 FR_CMR
 SG_ CHECKSUM : 7|16@0+ (1,0) [0|65535] "" XXX
 SG_ COUNTER : 16|8@1+ (1,0) [0|255] "" XXX

BO_ 864 NEW_MSG_360: 32 FR_CMR
 SG_ CHECKSUM : 7|16@0+ (1,0) [0|65535] "" XXX
 SG_ COUNTER : 16|8@1+ (1,0) [0|255] "" XXX

BO_ 865 NEW_MSG_361: 32 FR_CMR
 SG_ CHECKSUM : 7|16@0+ (1,0) [0|65535] "" XXX
 SG_ COUNTER : 16|8@1+ (1,0) [0|255] "" XXX

BO_ 867 NEW_MSG_363: 32 FR_CMR
 SG_ CHECKSUM : 7|16@0+ (1,0) [0|65535] "" XXX
 SG_ COUNTER : 16|8@1+ (1,0) [0|255] "" XXX

BO_ 868 NEW_MSG_364: 32 FR_CMR
 SG_ CHECKSUM : 7|16@0+ (1,0) [0|65535] "" XXX
 SG_ COUNTER : 16|8@1+ (1,0) [0|255] "" XXX

BO_ 869 NEW_MSG_365: 32 FR_CMR
 SG_ CHECKSUM : 7|16@0+ (1,0) [0|65535] "" XXX
 SG_ COUNTER : 16|8@1+ (1,0) [0|255] "" XXX

BO_ 870 NEW_MSG_366: 32 FR_CMR
 SG_ CHECKSUM : 7|16@0+ (1,0) [0|65535] "" XXX
 SG_ COUNTER : 16|8@1+ (1,0) [0|255] "" XXX

BO_ 896 NEW_MSG_380: 24 XXX
 SG_ CHECKSUM : 7|16@0+ (1,0) [0|65535] "" FR_CMR
 SG_ COUNTER : 16|8@1+ (1,0) [0|255] "" FR_CMR

BO_ 917 NEW_MSG_395: 32 XXX
 SG_ CHECKSUM : 7|16@0+ (1,0) [0|255] "" FR_CMR
 SG_ COUNTER : 23|8@0+ (1,0) [0|65535] "" FR_CMR

BO_ 928 NEW_MSG_3A0: 32 XXX
 SG_ CHECKSUM : 7|16@0+ (1,0) [0|255] "" FR_CMR
 SG_ COUNTER : 23|8@0+ (1,0) [0|255] "" FR_CMR

BO_ 933 NEW_MSG_3A5: 24 XXX
 SG_ CHECKSUM : 7|16@0+ (1,0) [0|65535] "" FR_CMR
 SG_ COUNTER : 23|8@0+ (1,0) [0|255] "" FR_CMR

BO_ 934 NEW_MSG_3A6: 24 XXX
 SG_ CHECKSUM : 7|16@0+ (1,0) [0|65535] "" FR_CMR
 SG_ COUNTER : 23|8@0+ (1,0) [0|255] "" FR_CMR

BO_ 935 NEW_MSG_3A7: 24 XXX
 SG_ CHECKSUM : 7|16@0+ (1,0) [0|65535] "" FR_CMR
 SG_ COUNTER : 23|8@0+ (1,0) [0|255] "" FR_CMR

BO_ 936 NEW_MSG_3A8: 24 XXX
 SG_ CHECKSUM : 7|16@0+ (1,0) [0|65535] "" FR_CMR
 SG_ COUNTER : 23|8@0+ (1,0) [0|255] "" FR_CMR

BO_ 937 NEW_MSG_3A9: 24 XXX
 SG_ CHECKSUM : 7|16@0+ (1,0) [0|65535] "" FR_CMR
 SG_ COUNTER : 23|8@0+ (1,0) [0|255] "" FR_CMR

BO_ 938 NEW_MSG_3AA: 24 XXX
 SG_ CHECKSUM : 7|16@0+ (1,0) [0|65535] "" FR_CMR
 SG_ COUNTER : 23|8@0+ (1,0) [0|255] "" FR_CMR

BO_ 939 NEW_MSG_3AB: 24 XXX
 SG_ CHECKSUM : 7|16@0+ (1,0) [0|65535] "" FR_CMR
 SG_ COUNTER : 23|8@0+ (1,0) [0|255] "" FR_CMR

BO_ 940 NEW_MSG_3AC: 24 XXX
 SG_ CHECKSUM : 7|16@0+ (1,0) [0|65535] "" FR_CMR
 SG_ COUNTER : 23|8@0+ (1,0) [0|255] "" FR_CMR

BO_ 941 NEW_MSG_3AD: 24 XXX
 SG_ CHECKSUM : 7|16@0+ (1,0) [0|65535] "" FR_CMR
 SG_ COUNTER : 23|8@0+ (1,0) [0|255] "" FR_CMR

BO_ 942 NEW_MSG_3AE: 24 XXX
 SG_ CHECKSUM : 7|16@0+ (1,0) [0|65535] "" FR_CMR
 SG_ COUNTER : 23|8@0+ (1,0) [0|255] "" FR_CMR

BO_ 943 NEW_MSG_3AF: 24 XXX
 SG_ CHECKSUM : 7|16@0+ (1,0) [0|65535] "" FR_CMR
 SG_ COUNTER : 23|8@0+ (1,0) [0|255] "" FR_CMR

BO_ 944 NEW_MSG_3B0: 24 XXX
 SG_ CHECKSUM : 7|16@0+ (1,0) [0|65535] "" FR_CMR
 SG_ COUNTER : 23|8@0+ (1,0) [0|255] "" FR_CMR

BO_ 945 NEW_MSG_3B1: 24 XXX
 SG_ CHECKSUM : 7|16@0+ (1,0) [0|65535] "" FR_CMR
 SG_ COUNTER : 23|8@0+ (1,0) [0|255] "" FR_CMR

BO_ 946 NEW_MSG_3B2: 24 XXX
 SG_ CHECKSUM : 7|16@0+ (1,0) [0|65535] "" FR_CMR
 SG_ COUNTER : 23|8@0+ (1,0) [0|255] "" FR_CMR

BO_ 947 NEW_MSG_3B3: 24 XXX
 SG_ CHECKSUM : 7|16@0+ (1,0) [0|65535] "" FR_CMR
 SG_ COUNTER : 23|8@0+ (1,0) [0|255] "" FR_CMR

BO_ 948 NEW_MSG_3B4: 24 XXX
 SG_ CHECKSUM : 7|16@0+ (1,0) [0|65535] "" FR_CMR
 SG_ COUNTER : 23|8@0+ (1,0) [0|255] "" FR_CMR

BO_ 949 NEW_MSG_3B5: 24 XXX
 SG_ CHECKSUM : 7|16@0+ (1,0) [0|65535] "" FR_CMR
 SG_ COUNTER : 16|8@1+ (1,0) [0|255] "" FR_CMR

BO_ 950 NEW_MSG_3B6: 24 XXX
 SG_ CHECKSUM : 7|16@0+ (1,0) [0|65535] "" FR_CMR
 SG_ COUNTER : 16|8@1+ (1,0) [0|255] "" FR_CMR

BO_ 951 NEW_MSG_3B7: 24 XXX
 SG_ CHECKSUM : 7|16@0+ (1,0) [0|65535] "" FR_CMR
 SG_ COUNTER : 16|8@1+ (1,0) [0|255] "" FR_CMR

BO_ 952 NEW_MSG_3B8: 24 XXX
 SG_ CHECKSUM : 7|16@0+ (1,0) [0|65535] "" FR_CMR
 SG_ COUNTER : 16|8@1+ (1,0) [0|255] "" FR_CMR

BO_ 953 NEW_MSG_3B9: 24 XXX
 SG_ CHECKSUM : 7|16@0+ (1,0) [0|65535] "" FR_CMR
 SG_ COUNTER : 16|8@1+ (1,0) [0|255] "" FR_CMR

BO_ 954 NEW_MSG_3BA: 24 XXX
 SG_ CHECKSUM : 7|16@0+ (1,0) [0|65535] "" FR_CMR
 SG_ COUNTER : 16|8@1+ (1,0) [0|255] "" FR_CMR

BO_ 955 NEW_MSG_3BB: 24 XXX
 SG_ CHECKSUM : 7|16@0+ (1,0) [0|65535] "" FR_CMR
 SG_ COUNTER : 16|8@1+ (1,0) [0|255] "" FR_CMR

BO_ 956 NEW_MSG_3BC: 24 XXX
 SG_ CHECKSUM : 7|16@0+ (1,0) [0|65535] "" FR_CMR
 SG_ COUNTER : 16|8@1+ (1,0) [0|255] "" FR_CMR

BO_ 957 NEW_MSG_3BD: 24 XXX
 SG_ CHECKSUM : 7|16@0+ (1,0) [0|65535] "" FR_CMR
 SG_ COUNTER : 16|8@1+ (1,0) [0|255] "" FR_CMR

BO_ 958 NEW_MSG_3BE: 24 XXX
 SG_ CHECKSUM : 7|16@0+ (1,0) [0|65535] "" FR_CMR
 SG_ COUNTER : 16|8@1+ (1,0) [0|255] "" FR_CMR

BO_ 959 NEW_MSG_3BF: 24 XXX
 SG_ CHECKSUM : 7|16@0+ (1,0) [0|65535] "" FR_CMR
 SG_ COUNTER : 16|8@1+ (1,0) [0|255] "" FR_CMR

BO_ 960 NEW_MSG_3C0: 24 XXX
 SG_ CHECKSUM : 7|16@0+ (1,0) [0|65535] "" FR_CMR
 SG_ COUNTER : 16|8@1+ (1,0) [0|255] "" FR_CMR

BO_ 962 NEW_MSG_3C2: 24 XXX
 SG_ CHECKSUM : 7|16@0+ (1,0) [0|65535] "" FR_CMR
 SG_ COUNTER : 16|8@1+ (1,0) [0|255] "" FR_CMR

BO_ 963 NEW_MSG_3C3: 24 XXX
 SG_ CHECKSUM : 7|16@0+ (1,0) [0|65535] "" FR_CMR
 SG_ COUNTER : 16|8@1+ (1,0) [0|255] "" FR_CMR

BO_ 964 NEW_MSG_3C4: 24 XXX
 SG_ CHECKSUM : 7|16@0+ (1,0) [0|65535] "" FR_CMR
 SG_ COUNTER : 16|8@1+ (1,0) [0|255] "" FR_CMR

BO_ 976 NEW_MSG_3D0: 32 XXX
 SG_ CHECKSUM : 7|16@0+ (1,0) [0|65535] "" FR_CMR
 SG_ COUNTER : 16|8@1+ (1,0) [0|255] "" FR_CMR

BO_ 977 NEW_MSG_3D1: 32 XXX
 SG_ CHECKSUM : 7|16@0+ (1,0) [0|65535] "" FR_CMR
 SG_ COUNTER : 16|8@1+ (1,0) [0|127] "" FR_CMR

BO_ 978 NEW_MSG_3D2: 32 XXX
 SG_ CHECKSUM : 7|16@0+ (1,0) [0|65535] "" FR_CMR
 SG_ COUNTER : 16|8@1+ (1,0) [0|255] "" FR_CMR

BO_ 979 NEW_MSG_3D3: 32 XXX
 SG_ CHECKSUM : 7|16@0+ (1,0) [0|32767] "" FR_CMR
 SG_ COUNTER : 16|8@1+ (1,0) [0|255] "" FR_CMR

BO_ 980 NEW_MSG_3D4: 32 XXX
 SG_ CHECKSUM : 7|16@0+ (1,0) [0|65535] "" FR_CMR
 SG_ NEW_SIGNAL_1 : 16|8@1+ (1,0) [0|255] "" FR_CMR

BO_ 1280 NEW_MSG_500: 16 XXX
 SG_ CHECKSUM : 7|16@0+ (1,0) [0|65535] "" FR_CMR
 SG_ COUNTER : 16|8@1+ (1,0) [0|255] "" FR_CMR
 SG_ NEW_SIGNAL_3_SPEED_DEPENDANT : 24|8@1+ (1,0) [0|255] "" FR_CMR

CM_ BO_ 976 "(all 0)";
CM_ BO_ 977 "(all 0)";
CM_ BO_ 978 "(all 0)";
CM_ BO_ 979 "(all 0)";
CM_ BO_ 980 "(all 0)";
CM_ SG_ 1280 NEW_SIGNAL_3_SPEED_DEPENDANT "I dont know what this is but it IS speed dependant";
