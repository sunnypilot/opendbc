VERSION ""

NS_ :

BS_:

BU_: XXX CAMERA FRONT_RADAR ADRV APRK

BO_ 80 LKAS: 16 XXX
 SG_ CHECKSUM : 0|16@1+ (1,0) [0|65535] "" XXX
 SG_ COUNTER : 16|8@1+ (1,0) [0|255] "" XXX
 SG_ LKA_OptUsmSta : 24|3@1+ (1,0) [0|7] "" ADAS_DRV
 SG_ LKA_RcgSta : 27|3@1+ (1,0) [0|7] "" ADAS_DRV
 SG_ LKA_LHLnWrnSta : 30|2@1+ (1,0) [0|3] "" ADAS_DRV
 SG_ LKA_RHLnWrnSta : 32|2@1+ (1,0) [0|3] "" ADAS_DRV
 SG_ LKA_HndsoffSnd : 34|2@1+ (1,0) [0|3] "" ADAS_DRV
 SG_ LKA_StrSnd : 36|2@1+ (1,0) [0|3] "" ADAS_DRV
 SG_ LKA_SysIndReq : 38|3@1+ (1,0) [0|7] "" ADAS_DRV
 SG_ StrTqReqVal : 41|11@1+ (1,-1024) [0|4095] "" XXX
 SG_ ActToiSta : 52|2@1+ (1,0) [0|3] "" ADAS_DRV
 SG_ ToiFltSta : 54|2@1+ (1,0) [0|3] "" ADAS_DRV
 SG_ LFA_BUTTON : 56|1@1+ (1,0) [0|255] "" XXX
 SG_ LKA_SysWrn : 60|4@1+ (1,0) [0|15] "" ADAS_DRV
 SG_ Damping_Gain : 64|8@1+ (1,0) [0|255] "" CGW
 SG_ LKA_UsmMod : 80|2@1+ (1,0) [0|3] "" ADAS_DRV
 SG_ Info_PedtrnDst : 84|3@1+ (1,0) [0|7] "" ADAS_DRV

BO_ 81 ADRV_0x51: 32 ADRV
 SG_ CHECKSUM : 0|16@1+ (1,0) [0|65535] "" XXX
 SG_ COUNTER : 16|8@1+ (1,0) [0|255] "" XXX

BO_ 384 RADAR_TRACK_180: 32 RADAR
 SG_ CHECKSUM : 0|16@1+ (1,0) [0|65535] "" XXX
 SG_ COUNTER : 16|8@1+ (1,0) [0|255] "" XXX
 SG_ VALID_CNT1 : 32|8@1+ (1,0) [0|255] "" XXX
 SG_ TRACK_ID1 : 42|8@1+ (1,0) [0|255] "" XXX
 SG_ LONG_DIST1 : 64|13@1+ (0.05,0) [0|8191] "" XXX
 SG_ LAT_DIST1 : 78|11@1- (0.05,0) [0|4095] "" XXX
 SG_ REL_SPEED1 : 91|11@1- (0.05,2.4) [0|2047] "" XXX
 SG_ LAT_SPEED1 : 104|9@1- (0.05,0.6) [0|511] "" XXX
 SG_ REL_ACCEL1 : 115|9@1- (0.1,0) [0|511] "" XXX
 SG_ TRACK_HEARTBEAT1 : 124|4@1+ (1,0) [0|15] "" XXX
 SG_ VALID_CNT2 : 160|8@1+ (1,0) [0|255] "" XXX
 SG_ TRACK_ID2 : 170|8@1+ (1,0) [0|255] "" XXX
 SG_ LONG_DIST2 : 192|13@1+ (0.05,0) [0|8191] "" XXX
 SG_ LAT_DIST2 : 206|11@1- (0.05,0) [0|4095] "" XXX
 SG_ REL_SPEED2 : 219|11@1- (0.05,2.4) [0|2047] "" XXX
 SG_ LAT_SPEED2 : 232|9@1- (0.05,0.6) [0|511] "" XXX
 SG_ REL_ACCEL2 : 243|9@1- (0.1,0) [0|511] "" XXX
 SG_ TRACK_HEARTBEAT2 : 252|4@1+ (1,0) [0|15] "" XXX

BO_ 385 RADAR_TRACK_181: 32 RADAR
 SG_ CHECKSUM : 0|16@1+ (1,0) [0|65535] "" XXX
 SG_ COUNTER : 16|8@1+ (1,0) [0|255] "" XXX
 SG_ VALID_CNT1 : 32|8@1+ (1,0) [0|255] "" XXX
 SG_ TRACK_ID1 : 42|8@1+ (1,0) [0|255] "" XXX
 SG_ LONG_DIST1 : 64|13@1+ (0.05,0) [0|8191] "" XXX
 SG_ LAT_DIST1 : 78|11@1- (0.05,0) [0|4095] "" XXX
 SG_ REL_SPEED1 : 91|11@1- (0.05,2.4) [0|2047] "" XXX
 SG_ LAT_SPEED1 : 104|9@1- (0.05,0.6) [0|511] "" XXX
 SG_ REL_ACCEL1 : 115|9@1- (0.1,0) [0|511] "" XXX
 SG_ TRACK_HEARTBEAT1 : 124|4@1+ (1,0) [0|15] "" XXX
 SG_ VALID_CNT2 : 160|8@1+ (1,0) [0|255] "" XXX
 SG_ TRACK_ID2 : 170|8@1+ (1,0) [0|255] "" XXX
 SG_ LONG_DIST2 : 192|13@1+ (0.05,0) [0|8191] "" XXX
 SG_ LAT_DIST2 : 206|11@1- (0.05,0) [0|4095] "" XXX
 SG_ REL_SPEED2 : 219|11@1- (0.05,2.4) [0|2047] "" XXX
 SG_ LAT_SPEED2 : 232|9@1- (0.05,0.6) [0|511] "" XXX
 SG_ REL_ACCEL2 : 243|9@1- (0.1,0) [0|511] "" XXX
 SG_ TRACK_HEARTBEAT2 : 252|4@1+ (1,0) [0|15] "" XXX

BO_ 386 RADAR_TRACK_182: 32 RADAR
 SG_ CHECKSUM : 0|16@1+ (1,0) [0|65535] "" XXX
 SG_ COUNTER : 16|8@1+ (1,0) [0|255] "" XXX
 SG_ VALID_CNT1 : 32|8@1+ (1,0) [0|255] "" XXX
 SG_ TRACK_ID1 : 42|8@1+ (1,0) [0|255] "" XXX
 SG_ LONG_DIST1 : 64|13@1+ (0.05,0) [0|8191] "" XXX
 SG_ LAT_DIST1 : 78|11@1- (0.05,0) [0|4095] "" XXX
 SG_ REL_SPEED1 : 91|11@1- (0.05,2.4) [0|2047] "" XXX
 SG_ LAT_SPEED1 : 104|9@1- (0.05,0.6) [0|511] "" XXX
 SG_ REL_ACCEL1 : 115|9@1- (0.1,0) [0|511] "" XXX
 SG_ TRACK_HEARTBEAT1 : 124|4@1+ (1,0) [0|15] "" XXX
 SG_ VALID_CNT2 : 160|8@1+ (1,0) [0|255] "" XXX
 SG_ TRACK_ID2 : 170|8@1+ (1,0) [0|255] "" XXX
 SG_ LONG_DIST2 : 192|13@1+ (0.05,0) [0|8191] "" XXX
 SG_ LAT_DIST2 : 206|11@1- (0.05,0) [0|4095] "" XXX
 SG_ REL_SPEED2 : 219|11@1- (0.05,2.4) [0|2047] "" XXX
 SG_ LAT_SPEED2 : 232|9@1- (0.05,0.6) [0|511] "" XXX
 SG_ REL_ACCEL2 : 243|9@1- (0.1,0) [0|511] "" XXX
 SG_ TRACK_HEARTBEAT2 : 252|4@1+ (1,0) [0|15] "" XXX

BO_ 387 RADAR_TRACK_183: 32 RADAR
 SG_ CHECKSUM : 0|16@1+ (1,0) [0|65535] "" XXX
 SG_ COUNTER : 16|8@1+ (1,0) [0|255] "" XXX
 SG_ VALID_CNT1 : 32|8@1+ (1,0) [0|255] "" XXX
 SG_ TRACK_ID1 : 42|8@1+ (1,0) [0|255] "" XXX
 SG_ LONG_DIST1 : 64|13@1+ (0.05,0) [0|8191] "" XXX
 SG_ LAT_DIST1 : 78|11@1- (0.05,0) [0|4095] "" XXX
 SG_ REL_SPEED1 : 91|11@1- (0.05,2.4) [0|2047] "" XXX
 SG_ LAT_SPEED1 : 104|9@1- (0.05,0.6) [0|511] "" XXX
 SG_ REL_ACCEL1 : 115|9@1- (0.1,0) [0|511] "" XXX
 SG_ TRACK_HEARTBEAT1 : 124|4@1+ (1,0) [0|15] "" XXX
 SG_ VALID_CNT2 : 160|8@1+ (1,0) [0|255] "" XXX
 SG_ TRACK_ID2 : 170|8@1+ (1,0) [0|255] "" XXX
 SG_ LONG_DIST2 : 192|13@1+ (0.05,0) [0|8191] "" XXX
 SG_ LAT_DIST2 : 206|11@1- (0.05,0) [0|4095] "" XXX
 SG_ REL_SPEED2 : 219|11@1- (0.05,2.4) [0|2047] "" XXX
 SG_ LAT_SPEED2 : 232|9@1- (0.05,0.6) [0|511] "" XXX
 SG_ REL_ACCEL2 : 243|9@1- (0.1,0) [0|511] "" XXX
 SG_ TRACK_HEARTBEAT2 : 252|4@1+ (1,0) [0|15] "" XXX

BO_ 388 RADAR_TRACK_184: 32 RADAR
 SG_ CHECKSUM : 0|16@1+ (1,0) [0|65535] "" XXX
 SG_ COUNTER : 16|8@1+ (1,0) [0|255] "" XXX
 SG_ VALID_CNT1 : 32|8@1+ (1,0) [0|255] "" XXX
 SG_ TRACK_ID1 : 42|8@1+ (1,0) [0|255] "" XXX
 SG_ LONG_DIST1 : 64|13@1+ (0.05,0) [0|8191] "" XXX
 SG_ LAT_DIST1 : 78|11@1- (0.05,0) [0|4095] "" XXX
 SG_ REL_SPEED1 : 91|11@1- (0.05,2.4) [0|2047] "" XXX
 SG_ LAT_SPEED1 : 104|9@1- (0.05,0.6) [0|511] "" XXX
 SG_ REL_ACCEL1 : 115|9@1- (0.1,0) [0|511] "" XXX
 SG_ TRACK_HEARTBEAT1 : 124|4@1+ (1,0) [0|15] "" XXX
 SG_ VALID_CNT2 : 160|8@1+ (1,0) [0|255] "" XXX
 SG_ TRACK_ID2 : 170|8@1+ (1,0) [0|255] "" XXX
 SG_ LONG_DIST2 : 192|13@1+ (0.05,0) [0|8191] "" XXX
 SG_ LAT_DIST2 : 206|11@1- (0.05,0) [0|4095] "" XXX
 SG_ REL_SPEED2 : 219|11@1- (0.05,2.4) [0|2047] "" XXX
 SG_ LAT_SPEED2 : 232|9@1- (0.05,0.6) [0|511] "" XXX
 SG_ REL_ACCEL2 : 243|9@1- (0.1,0) [0|511] "" XXX
 SG_ TRACK_HEARTBEAT2 : 252|4@1+ (1,0) [0|15] "" XXX

BO_ 389 CAM_0x185: 8 CAMERA
 SG_ CHECKSUM : 0|16@1+ (1,0) [0|65535] "" XXX
 SG_ COUNTER : 16|8@1+ (1,0) [0|255] "" XXX

BO_ 438 CAM_0x1b6: 32 CAMERA
 SG_ CHECKSUM : 0|16@1+ (1,0) [0|65535] "" XXX
 SG_ COUNTER : 16|8@1+ (1,0) [0|255] "" XXX

BO_ 439 CAM_0x1b7: 32 CAMERA
 SG_ CHECKSUM : 0|16@1+ (1,0) [0|65535] "" XXX
 SG_ COUNTER : 16|8@1+ (1,0) [0|255] "" XXX

BO_ 440 CAM_0x1b8: 32 CAMERA
 SG_ CHECKSUM : 0|16@1+ (1,0) [0|65535] "" XXX
 SG_ COUNTER : 16|8@1+ (1,0) [0|255] "" XXX

BO_ 441 CAM_0x1b9: 32 CAMERA
 SG_ CHECKSUM : 0|16@1+ (1,0) [0|65535] "" XXX
 SG_ COUNTER : 16|8@1+ (1,0) [0|255] "" XXX

BO_ 513 RADAR_0x201: 32 FRONT_RADAR
 SG_ CHECKSUM : 0|16@1+ (1,0) [0|65535] "" XXX
 SG_ COUNTER : 16|8@1+ (1,0) [0|255] "" XXX

BO_ 528 RADAR_0x210: 32 FRONT_RADAR
 SG_ CHECKSUM : 0|16@1+ (1,0) [0|65535] "" XXX
 SG_ COUNTER : 16|8@1+ (1,0) [0|255] "" XXX

BO_ 529 RADAR_0x211: 32 FRONT_RADAR
 SG_ CHECKSUM : 0|16@1+ (1,0) [0|65535] "" XXX
 SG_ COUNTER : 16|8@1+ (1,0) [0|255] "" XXX

BO_ 530 RADAR_0x212: 32 FRONT_RADAR
 SG_ CHECKSUM : 0|16@1+ (1,0) [0|65535] "" XXX
 SG_ COUNTER : 16|8@1+ (1,0) [0|255] "" XXX

BO_ 531 RADAR_0x213: 32 FRONT_RADAR
 SG_ CHECKSUM : 0|16@1+ (1,0) [0|65535] "" XXX
 SG_ COUNTER : 16|8@1+ (1,0) [0|255] "" XXX

BO_ 532 RADAR_0x214: 32 FRONT_RADAR
 SG_ CHECKSUM : 0|16@1+ (1,0) [0|65535] "" XXX
 SG_ COUNTER : 16|8@1+ (1,0) [0|255] "" XXX

BO_ 533 RADAR_0x215: 32 FRONT_RADAR
 SG_ CHECKSUM : 0|16@1+ (1,0) [0|65535] "" XXX
 SG_ COUNTER : 16|8@1+ (1,0) [0|255] "" XXX

BO_ 534 RADAR_0x216: 32 FRONT_RADAR
 SG_ CHECKSUM : 0|16@1+ (1,0) [0|65535] "" XXX
 SG_ COUNTER : 16|8@1+ (1,0) [0|255] "" XXX

BO_ 535 RADAR_0x217: 32 FRONT_RADAR
 SG_ CHECKSUM : 0|16@1+ (1,0) [0|65535] "" XXX
 SG_ COUNTER : 16|8@1+ (1,0) [0|255] "" XXX

BO_ 536 RADAR_0x218: 32 FRONT_RADAR
 SG_ CHECKSUM : 0|16@1+ (1,0) [0|65535] "" XXX
 SG_ COUNTER : 16|8@1+ (1,0) [0|255] "" XXX

BO_ 537 RADAR_0x219: 32 FRONT_RADAR
 SG_ CHECKSUM : 0|16@1+ (1,0) [0|65535] "" XXX
 SG_ COUNTER : 16|8@1+ (1,0) [0|255] "" XXX

BO_ 538 RADAR_0x21a: 32 FRONT_RADAR
 SG_ CHECKSUM : 0|16@1+ (1,0) [0|65535] "" XXX
 SG_ COUNTER : 16|8@1+ (1,0) [0|255] "" XXX

BO_ 539 RADAR_0x21b: 32 FRONT_RADAR
 SG_ CHECKSUM : 0|16@1+ (1,0) [0|65535] "" XXX
 SG_ COUNTER : 16|8@1+ (1,0) [0|255] "" XXX

BO_ 540 RADAR_0x21c: 32 FRONT_RADAR
 SG_ CHECKSUM : 0|16@1+ (1,0) [0|65535] "" XXX
 SG_ COUNTER : 16|8@1+ (1,0) [0|255] "" XXX

BO_ 541 RADAR_0x21d: 32 FRONT_RADAR
 SG_ CHECKSUM : 0|16@1+ (1,0) [0|65535] "" XXX
 SG_ COUNTER : 16|8@1+ (1,0) [0|255] "" XXX

BO_ 542 RADAR_0x21e: 32 FRONT_RADAR
 SG_ CHECKSUM : 0|16@1+ (1,0) [0|65535] "" XXX
 SG_ COUNTER : 16|8@1+ (1,0) [0|255] "" XXX

BO_ 543 RADAR_0x21f: 32 FRONT_RADAR
 SG_ CHECKSUM : 0|16@1+ (1,0) [0|65535] "" XXX
 SG_ COUNTER : 16|8@1+ (1,0) [0|255] "" XXX

BO_ 576 RADAR_0x240: 16 FRONT_RADAR
 SG_ CHECKSUM : 0|16@1+ (1,0) [0|65535] "" XXX
 SG_ COUNTER : 16|8@1+ (1,0) [0|255] "" XXX

BO_ 674 CAM_0x2a2: 32 CAMERA
 SG_ CHECKSUM : 0|16@1+ (1,0) [0|65535] "" XXX
 SG_ COUNTER : 16|8@1+ (1,0) [0|255] "" XXX

BO_ 675 CAM_0x2a3: 32 CAMERA
 SG_ CHECKSUM : 0|16@1+ (1,0) [0|65535] "" XXX
 SG_ COUNTER : 16|8@1+ (1,0) [0|255] "" XXX

BO_ 676 CAM_0x2a4: 24 XXX
 SG_ CHECKSUM : 0|16@1+ (1,0) [0|65535] "" XXX
 SG_ COUNTER : 16|8@1+ (1,0) [0|255] "" XXX
 SG_ BYTE3 : 24|8@1+ (1,0) [0|255] "" XXX
 SG_ BYTE4 : 32|8@1+ (1,0) [0|255] "" XXX
 SG_ BYTE5 : 40|8@1+ (1,0) [0|255] "" XXX
 SG_ BYTE6 : 48|8@1+ (1,0) [0|255] "" XXX
 SG_ LEFT_LANE_LINE : 56|2@1+ (1,0) [0|3] "" XXX
 SG_ SET_ME_0 : 58|2@1+ (1,0) [0|3] "" XXX
 SG_ RIGHT_LANE_LINE : 60|2@1+ (1,0) [0|3] "" XXX
 SG_ SET_ME_0_2 : 62|2@1+ (1,0) [0|3] "" XXX
 SG_ BYTE8 : 64|8@1+ (1,0) [0|255] "" XXX
 SG_ BYTE9 : 72|8@1+ (1,0) [0|255] "" XXX
 SG_ BYTE10 : 80|8@1+ (1,0) [0|255] "" XXX
 SG_ BYTE11 : 88|8@1+ (1,0) [0|255] "" XXX
 SG_ BYTE12 : 96|8@1+ (1,0) [0|255] "" XXX
 SG_ BYTE13 : 104|8@1+ (1,0) [0|255] "" XXX
 SG_ BYTE14 : 112|8@1+ (1,0) [0|255] "" XXX
 SG_ BYTE15 : 120|8@1+ (1,0) [0|255] "" XXX
 SG_ BYTE16 : 128|8@1+ (1,0) [0|255] "" XXX
 SG_ BYTE17 : 136|8@1+ (1,0) [0|255] "" XXX
 SG_ BYTE18 : 144|8@1+ (1,0) [0|255] "" XXX
 SG_ BYTE19 : 152|8@1+ (1,0) [0|255] "" XXX
 SG_ BYTE20 : 160|8@1+ (1,0) [0|255] "" XXX
 SG_ BYTE21 : 168|8@1+ (1,0) [0|255] "" XXX
 SG_ BYTE22 : 176|8@1+ (1,0) [0|255] "" XXX
 SG_ BYTE23 : 184|8@1+ (1,0) [0|255] "" XXX

BO_ 699 CAM_0x2bb: 32 CAMERA
 SG_ CHECKSUM : 0|16@1+ (1,0) [0|65535] "" XXX
 SG_ COUNTER : 16|8@1+ (1,0) [0|255] "" XXX

BO_ 700 CAM_0x2bc: 32 CAMERA
 SG_ CHECKSUM : 0|16@1+ (1,0) [0|65535] "" XXX
 SG_ COUNTER : 16|8@1+ (1,0) [0|255] "" XXX

BO_ 701 CAM_0x2bd: 32 CAMERA
 SG_ CHECKSUM : 0|16@1+ (1,0) [0|65535] "" XXX
 SG_ COUNTER : 16|8@1+ (1,0) [0|255] "" XXX

BO_ 702 CAM_0x2be: 32 CAMERA
 SG_ CHECKSUM : 0|16@1+ (1,0) [0|65535] "" XXX
 SG_ COUNTER : 16|8@1+ (1,0) [0|255] "" XXX

CM_ BO_ 80 "Known in official DBC as L_ADAS_CMD_30_10ms";
CM_ SG_ 80 StrTqReqVal "This is the driver torque overlay demand value. A negative value represents a torque that would accelerate the steering wheel in a clockwise direction. This signal is always zero whilst the TOI is inactive. (the official DBC defines this as SG_ StrTqReqVal : xx|11@1+ (0.0078125,-8) [-8|7.9921875] \"Nm\" XXX but I am not changing it since it has a broader impact on the OP code)";
CM_ SG_ 80 ActToiSta "This is a flag that is set to 1 when requesting the steering to activate the torque overlay interface (TOI).  This must be done before an attempt is made to request non-zero steering torque overlay.";
CM_ SG_ 80 ToiFltSta "This fault flag is set when a fault in the LKA system has been detected by the LKA ECU such that LKA can no longer function. CAN failures, internal video ECU failures, hard-wired component (e.g. master switch) failures and other system logic failures are";
CM_ SG_ 80 LKA_SysWrn "A signal that provides additional information on the operation of the LKA system for the HMI to display to the driver. This includes additional fault information, reasons for unavailability of the system and additional warnings like the hands-off warning";
CM_ SG_ 80 LKA_UsmMod "This signal indicates LKA USM Mode";
CM_ SG_ 80 Info_PedtrnDst "Distance of the nearest pedestrian";
CM_ BO_ 676 "Contains signals with detailed lane line information. Used by ADAS ECU on HDA 2 vehicles to operate LFA.";
CM_ SG_ 676 LEFT_LANE_LINE "Left lane line confidence";
CM_ SG_ 676 RIGHT_LANE_LINE "Right lane line confidence";
VAL_ 80 LKA_OptUsmSta 0 "None LKA/LDW Option (Default)" 1 "LDW" 2 "LKA" 3 "Reserved" 4 "LDW Only (None LKA)" 5 "LDW only OFF (None LKA)" 6 "LDW/LKA OFF" 7 "Invalid";
VAL_ 80 LKA_RcgSta 0 "Not Recognized" 1 "Full Lane Recognized" 2 "Left Line Recognized" 3 "Right Line Recognized" 4 "Reserved" 5 "Reserved" 6 "Reserved" 7 "Reserved";
VAL_ 80 LKA_LHLnWrnSta 0 "No Warning" 1 "Lane Departure Warning" 2 "Reserved" 3 "Reserved";
VAL_ 80 LKA_RHLnWrnSta 0 "No Warning" 1 "Lane Departure Warning" 2 "Reserved" 3 "Reserved";
VAL_ 80 LKA_HndsoffSnd 0 "Off" 1 "Hands-off Sound Warning" 2 "Reserved" 3 "Reserved";
VAL_ 80 LKA_StrSnd 0 "Off" 1 "Warning" 2 "Reserved" 3 "Reserved";
VAL_ 80 LKA_SysIndReq 0 "Off" 1 "Unavailable_(Grey On)" 2 "Lane Recognized_(Green On)" 3 "Lane Departure_(Green Blink)" 4 "System Fail_(Orange On)" 5 "Not Calibrated_(Orange Blink)" 6 "Regulation_(Orange On)" 7 "Reserved";
VAL_ 80 ActToiSta 0 "De-activate TOI" 1 "Activate TOI" 2 "Reserved" 3 "Error indicator";
VAL_ 80 ToiFltSta 0 "No Fault" 1 "Fault" 2 "Reserved" 3 "Error indicatorr";
VAL_ 80 LKA_SysWrn 0 "No Info" 1 "Reserved" 2 "Reserved" 3 "Reserved" 4 "Hands-Off Warning 1" 5 "Hands-Off Warning 2" 6 "Reserved" 7 "Reserved" 8 "Reserved" 9 "System Automatic off" 10 "Reserved" 11 "Reserved" 12 "Reserved" 13 "Reserved" 14 "Reserved" 15 "System Fail";
VAL_ 80 LKA_UsmMod 0 "NONE" 1 "LKA 1 mode" 2 "LKA 2 mode" 3 "LDW";
VAL_ 676 LEFT_LANE_LINE 0 "Not Detected" 1 "Low Confidence" 2 "Medium Confidence" 3 "High Confidence";
VAL_ 676 RIGHT_LANE_LINE 0 "Not Detected" 1 "Low Confidence" 2 "Medium Confidence" 3 "High Confidence";
